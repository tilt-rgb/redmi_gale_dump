/dts-v1/;

/ {

	__fixups__ {
		accdet = "/fragment@9:target:0";
		auxadc = "/fragment@29:target:0", "/fragment@30/__overlay__:io-channels:0";
		chosen = "/fragment@4:target:0";
		consys = "/fragment@16:target:0";
		dispsys_config = "/fragment@21:target:0";
		dsi0 = "/fragment@22:target:0";
		dsi_te = "/fragment@52:target:0";
		flashlights_ocp8132 = "/fragment@67:target:0";
		fpsensor_finger = "/fragment@69:target:0";
		fpsensor_fp_eint = "/fragment@46:target:0";
		goodix_fp = "/fragment@47:target:0";
		gpio = "/fragment@42:target:0";
		gpio_usage_mapping = "/fragment@41:target:0";
		i2c0 = "/fragment@23:target:0", "/fragment@32:target:0";
		i2c1 = "/fragment@33:target:0";
		i2c2 = "/fragment@8:target:0", "/fragment@34:target:0";
		i2c3 = "/fragment@1:target:0", "/fragment@35:target:0";
		i2c4 = "/fragment@36:target:0";
		i2c5 = "/fragment@37:target:0";
		i2c6 = "/fragment@38:target:0";
		i2c7 = "/fragment@24:target:0", "/fragment@39:target:0";
		i2c8 = "/fragment@40:target:0";
		irq_nfc = "/fragment@45:target:0";
		irtx_pwm = "/fragment@17:target:0";
		kd_camera_hw1 = "/fragment@62:target:0", "/fragment@66:target:0";
		keypad = "/fragment@10:target:0", "/fragment@64:target:0";
		main_pmic = "/fragment@54:target:0";
		md1_sim1_hot_plug_eint = "/fragment@55:target:0";
		md1_sim2_hot_plug_eint = "/fragment@56:target:0";
		md_auxadc = "/fragment@30:target:0";
		mrdump_ext_rst = "/fragment@43:target:0";
		mt6370 = "/fragment@12:target:0";
		mt6370_typec = "/fragment@13:target:0";
		mt_pmic_vcama1_ldo_reg = "/fragment@57:target:0", "/fragment@62/__overlay__:vcama-supply:0", "/fragment@66/__overlay__:cam1_vcama-supply:0", "/fragment@66/__overlay__:cam2_vcama-supply:0";
		mt_pmic_vcama2_ldo_reg = "/fragment@58:target:0", "/fragment@62/__overlay__:vcama_sub-supply:0", "/fragment@66/__overlay__:cam0_vcama-supply:0";
		mt_pmic_vcamd_ldo_reg = "/fragment@59:target:0", "/fragment@62/__overlay__:vcamd_main2-supply:0", "/fragment@66/__overlay__:cam0_vcamd-supply:0";
		mt_pmic_vcamio_ldo_reg = "/fragment@34/__overlay__/camera_main_af@18:camio_m1_pmic-supply:0", "/fragment@60:target:0", "/fragment@62/__overlay__:vcamio-supply:0", "/fragment@62/__overlay__:vcamio_sub-supply:0", "/fragment@62/__overlay__:vcamio_main2-supply:0", "/fragment@66/__overlay__:cam0_vcamio-supply:0", "/fragment@66/__overlay__:cam1_vcamio-supply:0", "/fragment@66/__overlay__:cam2_vcamio-supply:0";
		mt_pmic_vio28_ldo_reg = "/fragment@34/__overlay__/camera_main_af@18:camaf_m1_pmic-supply:0", "/fragment@66/__overlay__:cam0_vcamaf-supply:0";
		mt_pmic_vldo28_ldo_reg = "/fragment@61:target:0", "/fragment@62/__overlay__:vcamaf-supply:0", "/fragment@62/__overlay__:vcamaf_sub-supply:0", "/fragment@62/__overlay__:vcamaf_main2-supply:0", "/fragment@63/__overlay__:vtouch-supply:0", "/fragment@68/__overlay__/fpc_tee@2:VFP-supply:0", "/fragment@68/__overlay__/fpc_tee@2:avdd-supply:0", "/fragment@69/__overlay__:VFP-supply:0", "/fragment@71/__overlay__:avdd-supply:0";
		mtee_svp = "/fragment@28:target:0";
		mtk_leds = "/fragment@5:target:0";
		mtkfb = "/fragment@20:target:0";
		mtkheap_region_svp = "/fragment@26:target:0";
		mtkheap_region_wfd = "/fragment@27:target:0";
		odm = "/fragment@7:target:0", "/fragment@74:target:0";
		pio = "/fragment@0/__overlay__/touch@0:chipone,rst-gpio:0", "/fragment@0/__overlay__/touch@0:chipone,irq-gpio:0", "/fragment@0/__overlay__/touch@0:focaltech,reset-gpio:0", "/fragment@0/__overlay__/touch@0:focaltech,irq-gpio:0", "/fragment@0/__overlay__/touch@0:novatek,reset-gpio:0", "/fragment@0/__overlay__/touch@0:novatek,irq-gpio:0", "/fragment@0/__overlay__/touch@0:omnivision,irq-gpio:0", "/fragment@0/__overlay__/touch@0:omnivision,reset-gpio:0", "/fragment@1/__overlay__/nxp@28:qcom,nq-irq:0", "/fragment@1/__overlay__/nxp@28:interrupt-parent:0", "/fragment@1/__overlay__/nxp@28:qcom,nq-ven:0", "/fragment@1/__overlay__/nxp@28:qcom,nq-firm:0", "/fragment@1/__overlay__/nxp@28:qcom,nq-clkreq:0", "/fragment@1/__overlay__/nxp@28:tms,irq-gpio:0", "/fragment@1/__overlay__/nxp@28:tms,ven-gpio:0", "/fragment@1/__overlay__/nxp@28:tms,download-gpio:0", "/fragment@2:target:0", "/fragment@11:target:0", "/fragment@12/__overlay__:interrupt-parent:0", "/fragment@13/__overlay__:mt6370pd-intr-gpios:0", "/fragment@15:target:0", "/fragment@18:target:0", "/fragment@19:target:0", "/fragment@22/__overlay__/panel1@0:reset-gpios:0", "/fragment@22/__overlay__/panel1@0:enp-gpios:0", "/fragment@22/__overlay__/panel1@0:enn-gpios:0", "/fragment@22/__overlay__/panel1@0:mi,esd-err-irq-gpio:0", "/fragment@41/__overlay__:GPIO_FDD_BAND_SUPPORT_DETECT_1ST_PIN:0", "/fragment@41/__overlay__:GPIO_FDD_BAND_SUPPORT_DETECT_3RD_PIN:0", "/fragment@41/__overlay__:GPIO_FDD_BAND_SUPPORT_DETECT_6TH_PIN:0", "/fragment@41/__overlay__:GPIO_FDD_BAND_SUPPORT_DETECT_4TH_PIN:0", "/fragment@41/__overlay__:GPIO_FDD_BAND_SUPPORT_DETECT_5TH_PIN:0", "/fragment@41/__overlay__:GPIO_SIM2_HOT_PLUG:0", "/fragment@41/__overlay__:GPIO_SIM1_HOT_PLUG:0", "/fragment@41/__overlay__:GPIO_SIM2_SIO:0", "/fragment@41/__overlay__:GPIO_SIM2_SRST:0", "/fragment@41/__overlay__:GPIO_SIM2_SCLK:0", "/fragment@41/__overlay__:GPIO_FDD_BAND_SUPPORT_DETECT_2ND_PIN:0", "/fragment@41/__overlay__:GPIO_SIM1_SCLK:0", "/fragment@41/__overlay__:GPIO_SIM1_SRST:0", "/fragment@41/__overlay__:GPIO_SIM1_SIO:0", "/fragment@43/__overlay__:interrupt-parent:0", "/fragment@43/__overlay__:deb-gpios:0", "/fragment@44/__overlay__:interrupt-parent:0", "/fragment@45/__overlay__:interrupt-parent:0", "/fragment@46/__overlay__:interrupt-parent:0", "/fragment@47/__overlay__:interrupt-parent:0", "/fragment@48/__overlay__:interrupt-parent:0", "/fragment@49/__overlay__:interrupt-parent:0", "/fragment@50/__overlay__:interrupt-parent:0", "/fragment@51/__overlay__:interrupt-parent:0", "/fragment@52/__overlay__:interrupt-parent:0", "/fragment@53/__overlay__:interrupt-parent:0", "/fragment@53/__overlay__:deb-gpios:0", "/fragment@54/__overlay__:interrupt-parent:0", "/fragment@65:target:0", "/fragment@70:target:0", "/fragment@72:target:0", "/fragment@73:target:0", "/fragment@74/__overlay__/audio_fs15xx:fsm,id-gpio:0", "/fragment@74/__overlay__/audio_fs15xx:fsm,cmd-gpio:0", "/fragment@74/__overlay__/audio_fs15xx:fsm,mod-gpio:0", "/fragment@75:target:0";
		pmic_clock_buffer_ctrl = "/fragment@31:target:0";
		reserved_memory = "/fragment@3:target:0";
		rt9465_slave_chr = "/fragment@51:target:0";
		silead_fp = "/fragment@71:target:0";
		smart_pa = "/fragment@49:target:0";
		sound = "/fragment@25:target:0";
		spi0 = "/fragment@0:target:0";
		spi2 = "/fragment@68:target:0";
		subpmic_pmu_eint = "/fragment@48:target:0";
		swtp = "/fragment@53:target:0";
		tcpc_pd = "/fragment@50:target:0";
		thermal_message = "/fragment@14:target:0";
		touch = "/fragment@44:target:0", "/fragment@63:target:0";
		utos = "/fragment@6:target:0";
	};

	__local_fixups__ {

		fragment@1 {

			__overlay__ {

				nxp@28 {
					pinctrl-0 = <0x0>;
					pinctrl-1 = <0x0 0x4 0x8 0xc>;
					pinctrl-2 = <0x0 0x4 0x8 0xc>;
				};
			};
		};

		fragment@10 {

			__overlay__ {
				pinctrl-0 = <0x0>;
			};
		};

		fragment@16 {

			__overlay__ {
				pinctrl-0 = <0x0>;
				pinctrl-1 = <0x0>;
				pinctrl-2 = <0x0>;
				pinctrl-3 = <0x0>;
			};
		};

		fragment@17 {

			__overlay__ {
				pinctrl-0 = <0x0>;
				pinctrl-1 = <0x0>;
			};
		};

		fragment@20 {

			__overlay__ {
				pinctrl-0 = <0x0>;
				pinctrl-1 = <0x0>;
				pinctrl-2 = <0x0>;
				pinctrl-3 = <0x0>;
			};
		};

		fragment@21 {

			__overlay__ {
				pinctrl-0 = <0x0>;
				pinctrl-1 = <0x0>;
				pinctrl-2 = <0x0>;
				pinctrl-3 = <0x0>;
			};
		};

		fragment@22 {

			__overlay__ {

				panel1@0 {

					port {

						endpoint {
							remote-endpoint = <0x0>;
						};
					};
				};

				ports {

					port {

						endpoint {
							remote-endpoint = <0x0>;
						};
					};
				};
			};
		};

		fragment@25 {

			__overlay__ {

				mediatek,speaker-codec {
					sound-dai = <0x0>;
				};
			};
		};

		fragment@66 {

			__overlay__ {
				pinctrl-0 = <0x0>;
				pinctrl-1 = <0x0>;
				pinctrl-10 = <0x0>;
				pinctrl-11 = <0x0>;
				pinctrl-12 = <0x0>;
				pinctrl-13 = <0x0>;
				pinctrl-14 = <0x0>;
				pinctrl-15 = <0x0>;
				pinctrl-16 = <0x0>;
				pinctrl-17 = <0x0>;
				pinctrl-18 = <0x0>;
				pinctrl-19 = <0x0>;
				pinctrl-2 = <0x0>;
				pinctrl-20 = <0x0>;
				pinctrl-21 = <0x0>;
				pinctrl-22 = <0x0>;
				pinctrl-23 = <0x0>;
				pinctrl-24 = <0x0>;
				pinctrl-25 = <0x0>;
				pinctrl-26 = <0x0>;
				pinctrl-27 = <0x0>;
				pinctrl-28 = <0x0>;
				pinctrl-29 = <0x0>;
				pinctrl-3 = <0x0>;
				pinctrl-30 = <0x0>;
				pinctrl-31 = <0x0>;
				pinctrl-4 = <0x0>;
				pinctrl-5 = <0x0>;
				pinctrl-6 = <0x0>;
				pinctrl-7 = <0x0>;
				pinctrl-8 = <0x0>;
				pinctrl-9 = <0x0>;
			};
		};

		fragment@67 {

			__overlay__ {
				pinctrl-0 = <0x0>;
				pinctrl-1 = <0x0>;
				pinctrl-2 = <0x0>;
				pinctrl-3 = <0x0>;
				pinctrl-4 = <0x0>;
			};
		};

		fragment@69 {

			__overlay__ {
				pinctrl-0 = <0x0>;
				pinctrl-1 = <0x0>;
				pinctrl-2 = <0x0>;
				pinctrl-3 = <0x0>;
			};
		};

		fragment@71 {

			__overlay__ {
				pinctrl-0 = <0x0>;
				pinctrl-1 = <0x0>;
				pinctrl-2 = <0x0>;
				pinctrl-3 = <0x0>;
				pinctrl-4 = <0x0>;
				pinctrl-5 = <0x0>;
				pinctrl-6 = <0x0>;
			};
		};

		fragment@74 {

			__overlay__ {

				audio_fs15xx {
					pinctrl-0 = <0x0>;
					pinctrl-1 = <0x0>;
					pinctrl-2 = <0x0>;
					pinctrl-3 = <0x0>;
				};
			};
		};
	};

	__symbols__ {
		bias_lcd = "/fragment@23/__overlay__/bias_lcd@3e";
		camera0_mclk_2mA = "/fragment@65/__overlay__/camera0_mclk_2mA@gpio100";
		camera0_mclk_4mA = "/fragment@65/__overlay__/camera0_mclk_4mA@gpio100";
		camera0_mclk_6mA = "/fragment@65/__overlay__/camera0_mclk_6mA@gpio100";
		camera0_mclk_8mA = "/fragment@65/__overlay__/camera0_mclk_8mA@gpio100";
		camera0_mclk_off = "/fragment@65/__overlay__/camera0_mclk_gpio_mode@gpio100";
		camera0_pdn_high = "/fragment@65/__overlay__/camera0_pdn_output_high@gpio98";
		camera0_pdn_low = "/fragment@65/__overlay__/camera0_pdn_output_low@gpio98";
		camera0_rst_high = "/fragment@65/__overlay__/camera0_rst_output_high@gpio102";
		camera0_rst_low = "/fragment@65/__overlay__/camera0_rst_output_low@gpio102";
		camera0_vcamd_off = "/fragment@65/__overlay__/camera0_vcamd_output_low@gpio178";
		camera0_vcamd_on = "/fragment@65/__overlay__/camera0_vcamd_output_high@gpio178";
		camera1_mclk_2mA = "/fragment@65/__overlay__/camera1_mclk_2mA@gpio99";
		camera1_mclk_4mA = "/fragment@65/__overlay__/camera1_mclk_4mA@gpio99";
		camera1_mclk_6mA = "/fragment@65/__overlay__/camera1_mclk_6mA@gpio99";
		camera1_mclk_8mA = "/fragment@65/__overlay__/camera1_mclk_8mA@gpio99";
		camera1_mclk_off = "/fragment@65/__overlay__/camera1_mclk_gpio_mode@gpio99";
		camera1_pdn_high = "/fragment@65/__overlay__/camera1_pdn_output_high@gpio97";
		camera1_pdn_low = "/fragment@65/__overlay__/camera1_pdn_output_low@gpio97";
		camera1_rst_high = "/fragment@65/__overlay__/camera1_rst_output_high@gpio101";
		camera1_rst_low = "/fragment@65/__overlay__/camera1_rst_output_low@gpio101";
		camera1_vcamd_off = "/fragment@65/__overlay__/camera1_vcamd_output_low@gpio179";
		camera1_vcamd_on = "/fragment@65/__overlay__/camera1_vcamd_output_high@gpio179";
		camera2_mclk_2mA = "/fragment@65/__overlay__/camera2_mclk_2mA@gpio108";
		camera2_mclk_4mA = "/fragment@65/__overlay__/camera2_mclk_4mA@gpio108";
		camera2_mclk_6mA = "/fragment@65/__overlay__/camera2_mclk_6mA@gpio108";
		camera2_mclk_8mA = "/fragment@65/__overlay__/camera2_mclk_8mA@gpio108";
		camera2_mclk_off = "/fragment@65/__overlay__/camera2_mclk_gpio_mode@gpio108";
		camera2_pdn_high = "/fragment@65/__overlay__/camera2_pdn_output_high@gpio110";
		camera2_pdn_low = "/fragment@65/__overlay__/camera2_pdn_output_low@gpio110";
		camera2_rst_high = "/fragment@65/__overlay__/camera2_rst_output_high@gpio109";
		camera2_rst_low = "/fragment@65/__overlay__/camera2_rst_output_low@gpio109";
		camera_main_af_mtk = "/fragment@34/__overlay__/camera_main_af@18";
		camera_main_eeprom_mtk = "/fragment@34/__overlay__/camera_main_eeprom@50";
		camera_main_mtk = "/fragment@34/__overlay__/camera_main@1a";
		camera_main_two_eeprom_mtk = "/fragment@34/__overlay__/camera_main_two_eeprom@52";
		camera_main_two_mtk = "/fragment@34/__overlay__/camera_main_two@10";
		camera_pins_default = "/fragment@65/__overlay__/camdefault";
		camera_sub_eeprom_mtk = "/fragment@36/__overlay__/camera_sub_eeprom@51";
		camera_sub_mtk = "/fragment@36/__overlay__/camera_sub@2d";
		ccu_sensor_i2c_2_hw_mtk = "/fragment@34/__overlay__/ccu_sensor_i2c_2_hw@11";
		ccu_sensor_i2c_4_hw_mtk = "/fragment@36/__overlay__/ccu_sensor_i2c_4_hw@12";
		consys_pins_default = "/fragment@15/__overlay__/consys_default";
		dsi_out = "/fragment@22/__overlay__/ports/port/endpoint";
		fingerprint_pins_default = "/fragment@72/__overlay__/fp_default";
		flashlight_pins_default = "/fragment@65/__overlay__/flashlightdefault";
		flashlight_pins_en_output0 = "/fragment@65/__overlay__/flashlightenoutput0";
		flashlight_pins_en_output1 = "/fragment@65/__overlay__/flashlightenoutput1";
		flashlight_pins_sel_output0 = "/fragment@65/__overlay__/flashlightseloutput0";
		flashlight_pins_sel_output1 = "/fragment@65/__overlay__/flashlightseloutput1";
		fpsensor_fpc_cs_high = "/fragment@70/__overlay__/fpsensor_fpc_cs_high";
		fpsensor_fpc_cs_low = "/fragment@70/__overlay__/fpsensor_fpc_cs_low";
		fpsensor_fpc_rst_high = "/fragment@70/__overlay__/fpsensor_fpc_rst_high";
		fpsensor_fpc_rst_low = "/fragment@70/__overlay__/fpsensor_fpc_rst_low";
		fs15xx = "/fragment@74/__overlay__/audio_fs15xx";
		fs15xx_cmd_default = "/fragment@75/__overlay__/fs15xx_cmd_default";
		fs15xx_id_active = "/fragment@75/__overlay__/fs15xx_id_active";
		fs15xx_id_default = "/fragment@75/__overlay__/fs15xx_id_default";
		fs15xx_mod_default = "/fragment@75/__overlay__/fs15xx_mod_default";
		gpslna_pins_init = "/fragment@15/__overlay__/gpslna@0";
		gpslna_pins_oh = "/fragment@15/__overlay__/gpslna@1";
		gpslna_pins_ol = "/fragment@15/__overlay__/gpslna@2";
		irtx_gpio_led_default = "/fragment@18/__overlay__/irtx_gpio_led_def@gpio12";
		irtx_gpio_led_set = "/fragment@18/__overlay__/irtx_gpio_led_set@gpio12";
		kpd_pins_default = "/fragment@11/__overlay__/kpdgpiodefault";
		led0 = "/fragment@7/__overlay__/led@0";
		led1 = "/fragment@7/__overlay__/led@1";
		led2 = "/fragment@7/__overlay__/led@2";
		led3 = "/fragment@7/__overlay__/led@3";
		led4 = "/fragment@7/__overlay__/led@4";
		led5 = "/fragment@7/__overlay__/led@5";
		led6 = "/fragment@7/__overlay__/led@6";
		mt6660 = "/fragment@24/__overlay__/mt6660@34";
		mtee = "/fragment@28/__overlay__/MTEE";
		mtkfb_pins_lcm_dsi_te = "/fragment@19/__overlay__/lcm_dsi_te";
		mtkfb_pins_lcm_err_flag = "/fragment@19/__overlay__/lcm_err_flag";
		mtkfb_pins_lcm_rst_out0_gpio = "/fragment@19/__overlay__/lcm_rst_out0_gpio";
		mtkfb_pins_lcm_rst_out1_gpio = "/fragment@19/__overlay__/lcm_rst_out1_gpio";
		nfc_clk_req_active = "/fragment@2/__overlay__/nfc_clk_req_active";
		nfc_clk_req_suspend = "/fragment@2/__overlay__/nfc_clk_req_suspend";
		nfc_default = "/fragment@2/__overlay__/nfc_default";
		nfc_enable_active = "/fragment@2/__overlay__/nfc_enable_active";
		nfc_enable_suspend = "/fragment@2/__overlay__/nfc_enable_suspend";
		nfc_firmwaredownload_active = "/fragment@2/__overlay__/nfc_firmwaredownload_active";
		nfc_firmwaredownload_suspend = "/fragment@2/__overlay__/nfc_firmwaredownload_suspend";
		nfc_int_active = "/fragment@2/__overlay__/nfc_int_active";
		nfc_int_suspend = "/fragment@2/__overlay__/nfc_int_suspend";
		panel_in1 = "/fragment@22/__overlay__/panel1@0/port/endpoint";
		silfp_default = "/fragment@73/__overlay__/silfpdefault";
		silfp_irq = "/fragment@73/__overlay__/fp_eint@8";
		silfp_irq_rst_high = "/fragment@73/__overlay__/state_irq_to_reset_high";
		silfp_irq_rst_low = "/fragment@73/__overlay__/state_irq_to_reset_low";
		silfp_rst_high = "/fragment@73/__overlay__/state_reset_high";
		silfp_rst_low = "/fragment@73/__overlay__/state_reset_low";
		slave_charger_mtk = "/fragment@39/__overlay__/slave_charger@4b";
		svp = "/fragment@28/__overlay__/SecureVideoPath";
		vibrator0 = "/fragment@7/__overlay__/vibrator@0";
	};

	fragment@0 {
		target = <0xffffffff>;

		__overlay__ {
			#address-cells = <0x1>;
			#size-cells = <0x0>;
			status = "okay";

			touch@0 {
				chipone,compensate-cap-max = <0x7f>;
				chipone,compensate-cap-min = <0x1>;
				chipone,gesture-lp-noise-max = <0x3e8>;
				chipone,gesture-lp-rawdata-max = <0x2710>;
				chipone,gesture-lp-rawdata-min = <0x64>;
				chipone,gesture-noise-max = <0x3e8>;
				chipone,gesture-rawdata-max = <0x2710>;
				chipone,gesture-rawdata-min = <0x64>;
				chipone,irq-gpio = <0xffffffff 0x1 0x2001>;
				chipone,noise-max = <0x3e8>;
				chipone,open-min = <0xc8>;
				chipone,rawdata-max = <0x2710>;
				chipone,rawdata-min = <0x64>;
				chipone,rst-gpio = <0xffffffff 0x5c 0x0>;
				chipone,short-min = <0xc8>;
				chipone,test-compensate-cap;
				chipone,test-gesture-lp-noise;
				chipone,test-gesture-lp-noise-frames = <0x32>;
				chipone,test-gesture-lp-rawdata;
				chipone,test-gesture-lp-rawdata-frames = <0x1>;
				chipone,test-gesture-noise;
				chipone,test-gesture-noise-frames = <0x32>;
				chipone,test-gesture-rawdata;
				chipone,test-gesture-rawdata-frames = <0x1>;
				chipone,test-int-pin;
				chipone,test-noise;
				chipone,test-noise-frames = <0x32>;
				chipone,test-open;
				chipone,test-rawdata;
				chipone,test-rawdata-frames = <0x1>;
				chipone,test-reset-pin;
				chipone,test-short;
				chipone,touch-charger-detect-enable;
				chipone,touch-charger-detect-psp = "POWER_SUPPLY_PROP_ONLINE";
				chipone,touch-charger-detect-psp-poll-interval = <0x3e8>;
				chipone,touch-charger-detect-psy-name = "usb";
				chipone,touch-charger-detect-type = "notify";
				chipone,touch-earjack-detect-enable;
				chipone,touch-earjack-poll-interval = <0x3e8>;
				chipone,touch-earjack-state-filepath = "/sys/bus/platform/drivers/Accdet_Driver/state";
				chipone,x-res = <0x2cf>;
				chipone,y-res = <0x63f>;
				compatible = "novatek,NVT-ts-spi", "focaltech,fts", "omnivision,tcm-spi", "chipone-tddi";
				focaltech,display-coords = <0x0 0x0 0x2cf 0x63f>;
				focaltech,irq-gpio = <0xffffffff 0x1 0x2001>;
				focaltech,max-touch-number = <0xa>;
				focaltech,reset-gpio = <0xffffffff 0x5c 0x0>;
				novatek,irq-gpio = <0xffffffff 0x1 0x2001>;
				novatek,mp-support-dt;
				novatek,reset-gpio = <0xffffffff 0x5c 0x0>;
				omnivision,irq-gpio = <0xffffffff 0x1 0x2001>;
				omnivision,reset-gpio = <0xffffffff 0x5c 0x0>;
				omnivision,spi-mode = <0x3>;
				reg = <0x0>;
				spi-max-frequency = <0x927c00>;
				status = "ok";

				novatek-mp-criteria-597D@0 {
					#address-cells = <0x1>;
					#size-cells = <0x0>;
					AIN_KEY = <0x0 0x1 0x2 0xff>;
					AIN_X = <0x0 0x1 0x2 0x3 0x4 0x5 0x6 0x7 0x8 0x9 0xa 0xb 0xc 0xd 0xe 0xf 0x10 0x11>;
					AIN_Y = <0x0 0x1 0x2 0x3 0x4 0x5 0x6 0x7 0x8 0x9 0xa 0xb 0xc 0xd 0xe 0xf 0x10 0x11 0x12 0x13 0x14 0x15 0x16 0x17 0x18 0x19 0x1a 0x1b 0x1c 0x1d 0x1e 0x1f>;
					IC_KEY_CFG_SIZE = <0x4>;
					IC_X_CFG_SIZE = <0x12>;
					IC_Y_CFG_SIZE = <0x20>;
					PS_Config_Diff_Test_Frame = <0x32>;
					PS_Config_Lmt_FW_CC_N = <0x28 0x28 0x28 0x27 0x25 0x25 0x23 0x23 0xffff0001 0xffff0001 0x23 0x23 0x24 0x25 0x26 0x27 0x28 0x28 0x29 0x28 0x27 0x26 0x25 0x25 0x23 0x23 0x22 0x22 0x23 0x23 0x24 0x25 0x26 0x27 0x28 0x29 0x29 0x28 0x27 0x27 0x25 0x25 0x24 0x23 0x23 0x23 0x23 0x24 0x25 0x26 0x27 0x28 0x28 0x2a 0x29 0x28 0x27 0x27 0x26 0x25 0x24 0x23 0x23 0x23 0x23 0x24 0x25 0x25 0x27 0x27 0x28 0x2a 0x29 0x28 0x28 0x27 0x27 0x25 0x25 0x23 0x23 0x23 0x23 0x25 0x26 0x27 0x28 0x28 0x29 0x2a 0x2a 0x2a 0x28 0x28 0x28 0x27 0x25 0x25 0x24 0x23 0x24 0x25 0x26 0x27 0x28 0x28 0x29 0x2a 0x2a 0x28 0x28 0x25 0x25 0x24 0x23 0x23 0x22 0x23 0x23 0x24 0x25 0x26 0x27 0x29 0x2a 0x2a 0x29 0x28 0x27 0x25 0x24 0x23 0x23 0x22 0x22 0x22 0x23 0x23 0x24 0x25 0x25 0x28 0x29 0x29 0x29 0x28 0x27 0x25 0x25 0x23 0x23 0x23 0x22 0x23 0x23 0x24 0x25 0x25 0x27 0x28 0x29 0x2a 0x2a 0x28 0x27 0x25 0x25 0x24 0x23 0x23 0x22 0x23 0x23 0x24 0x24 0x25 0x26 0x28 0x28 0x29 0x2a 0x28 0x27 0x25 0x25 0x24 0x23 0x23 0x22 0x23 0x24 0x25 0x25 0x25 0x27 0x28 0x29 0x2a 0x2a 0x28 0x28 0x25 0x25 0x25 0x24 0x23 0x23 0x23 0x25 0x25 0x25 0x26 0x27 0x28 0x2a 0x2a 0x2a 0x28 0x28 0x26 0x25 0x25 0x25 0x24 0x23 0x25 0x25 0x27 0x27 0x27 0x28 0x29 0x2a 0x2b 0x2a 0x29 0x28 0x27 0x26 0x25 0x25 0x25 0x24 0x24 0x25 0x25 0x26 0x27 0x27 0x28 0x29 0x2a 0x2b 0x2a 0x28 0x27 0x27 0x26 0x25 0x25 0x24 0x25 0x26 0x27 0x27 0x27 0x28 0x28 0x2a 0x2b 0x2a 0x29 0x28 0x28 0x27 0x27 0x26 0x25 0x25 0x25 0x25 0x27 0x27 0x27 0x28 0x28 0x2a 0x2a 0x2a 0x2a 0x28 0x28 0x28 0x27 0x27 0x26 0x25 0x27 0x28 0x28 0x28 0x28 0x29 0x2a 0x2b 0x2c 0x2c 0x2a 0x29 0x28 0x28 0x28 0x27 0x27 0x26 0x27 0x27 0x28 0x28 0x28 0x28 0x29 0x2a 0x2c 0x2c 0x2a 0x29 0x28 0x28 0x28 0x28 0x28 0x27 0x28 0x28 0x29 0x29 0x29 0x2a 0x2a 0x2c 0x2c 0x2c 0x2a 0x2a 0x29 0x28 0x28 0x28 0x28 0x28 0x28 0x28 0x28 0x29 0x29 0x2a 0x2a 0x2b 0x2c 0x2c 0x2c 0x2a 0x2a 0x2a 0x29 0x29 0x29 0x29 0x29 0x29 0x2a 0x2a 0x2a 0x2a 0x2a 0x2c 0x2d 0x2d 0x2c 0x2b 0x2a 0x2a 0x2a 0x2a 0x2a 0x2a 0x2a 0x2a 0x2a 0x2a 0x2a 0x2a 0x2b 0x2c 0x2d 0x2f 0x2e 0x2d 0x2d 0x2d 0x2c 0x2d 0x2c 0x2c 0x2c 0x2c 0x2d 0x2d 0x2d 0x2d 0x2d 0x2e 0x2f 0x2f 0x2e 0x2d 0x2d 0x2d 0x2c 0x2c 0x2c 0x2c 0x2c 0x2c 0x2c 0x2c 0x2d 0x2d 0x2d 0x2d 0x2f 0x30 0x2f 0x2e 0x2d 0x2d 0x2d 0x2d 0x2d 0x2d 0x2d 0x2d 0x2d 0x2d 0x2d 0x2d 0x2e 0x2f 0x2f 0x30 0x2f 0x2e 0x2e 0x2e 0x2e 0x2e 0x2e 0x2e 0x2d 0x2d 0x2d 0x2d 0x2d 0x2e 0x2e 0x2f 0x2f 0x30 0x2f 0x2f 0x2f 0x2f 0x2f 0x2f 0x2f 0x2f 0x2f 0x2f 0x2f 0x2f 0x2f 0x2f 0x2f 0x2f 0x30 0x31 0x30 0x2f 0x2f 0x2f 0x2f 0x2f 0x2f 0x30 0x2f 0x2f 0x2f 0x2f 0x2f 0x2f 0x2f 0x30 0x30 0x34 0x32 0x30 0x31 0x30 0x30 0x31 0x31 0x31 0x30 0x30 0x30 0x30 0x30 0x30 0x30 0x30 0x33 0x32 0x30 0x30 0x30 0x30 0x30 0x30 0x30 0x31 0x30 0x30 0x30 0x30 0x30 0x30 0x30 0x31 0x32 0x33 0x32 0x31 0x31 0x31 0x31 0x31 0x31 0x32 0x31 0x30 0x30 0x30 0x30 0x30 0x30 0x31 0x33 0x34 0x33 0x32 0x32 0x32 0x32 0x33 0x33 0x33 0x32 0x31 0x31 0x31 0x31 0x31 0x30 0x32 0x34 0x0 0x0 0x0>;
					PS_Config_Lmt_FW_CC_P = <0x5b 0x5b 0x59 0x56 0x54 0x52 0x50 0x50 0xffff 0xffff 0x4e 0x4e 0x51 0x52 0x55 0x56 0x59 0x5b 0x5c 0x5b 0x56 0x55 0x54 0x52 0x50 0x4e 0x4d 0x4d 0x4e 0x50 0x51 0x52 0x55 0x56 0x5b 0x5c 0x5c 0x5b 0x58 0x56 0x54 0x52 0x51 0x50 0x4e 0x4e 0x50 0x51 0x52 0x55 0x58 0x59 0x5b 0x5d 0x5c 0x5b 0x58 0x58 0x55 0x52 0x51 0x50 0x4e 0x4e 0x4e 0x51 0x52 0x54 0x56 0x58 0x5b 0x5d 0x5c 0x5b 0x59 0x58 0x56 0x54 0x52 0x50 0x50 0x50 0x50 0x52 0x55 0x56 0x59 0x59 0x5c 0x5d 0x5d 0x5d 0x5b 0x5b 0x59 0x58 0x54 0x52 0x51 0x50 0x51 0x52 0x55 0x58 0x59 0x5b 0x5c 0x5f 0x5d 0x5b 0x59 0x54 0x52 0x51 0x50 0x4e 0x4d 0x4e 0x50 0x51 0x52 0x55 0x56 0x5c 0x5d 0x5d 0x5c 0x5b 0x58 0x52 0x51 0x50 0x4e 0x4d 0x4b 0x4d 0x4e 0x50 0x51 0x52 0x54 0x59 0x5c 0x5c 0x5c 0x5b 0x58 0x52 0x52 0x50 0x50 0x4e 0x4d 0x4e 0x50 0x51 0x52 0x54 0x56 0x5b 0x5c 0x5d 0x5d 0x5b 0x58 0x54 0x52 0x51 0x50 0x4e 0x4d 0x4e 0x50 0x51 0x51 0x54 0x55 0x59 0x5b 0x5c 0x5f 0x5b 0x58 0x54 0x52 0x51 0x50 0x50 0x4d 0x50 0x51 0x52 0x52 0x54 0x56 0x5b 0x5c 0x5f 0x5d 0x5b 0x59 0x54 0x52 0x52 0x51 0x50 0x4e 0x50 0x52 0x52 0x54 0x55 0x58 0x5b 0x5d 0x5f 0x5d 0x5b 0x59 0x55 0x54 0x52 0x52 0x51 0x50 0x52 0x54 0x56 0x56 0x58 0x59 0x5c 0x5d 0x60 0x5d 0x5c 0x59 0x56 0x55 0x52 0x52 0x52 0x51 0x51 0x52 0x54 0x55 0x56 0x58 0x5b 0x5c 0x5f 0x60 0x5d 0x5b 0x58 0x56 0x55 0x54 0x52 0x51 0x52 0x55 0x56 0x56 0x58 0x59 0x5b 0x5d 0x60 0x5f 0x5c 0x5b 0x59 0x58 0x56 0x55 0x54 0x52 0x52 0x54 0x56 0x58 0x58 0x59 0x5b 0x5d 0x5f 0x5f 0x5d 0x5b 0x59 0x59 0x58 0x58 0x55 0x54 0x58 0x59 0x5b 0x5b 0x5b 0x5c 0x5d 0x60 0x63 0x61 0x5d 0x5c 0x5b 0x59 0x59 0x58 0x58 0x55 0x56 0x58 0x59 0x59 0x5b 0x5b 0x5c 0x5f 0x61 0x61 0x5f 0x5c 0x5b 0x5b 0x5b 0x59 0x59 0x58 0x59 0x5b 0x5c 0x5c 0x5c 0x5d 0x5f 0x61 0x63 0x63 0x5f 0x5d 0x5c 0x5b 0x5b 0x5b 0x59 0x59 0x59 0x5b 0x5b 0x5c 0x5c 0x5d 0x5d 0x60 0x63 0x63 0x61 0x5f 0x5d 0x5d 0x5c 0x5c 0x5c 0x5c 0x5c 0x5c 0x5d 0x5d 0x5d 0x5f 0x5f 0x61 0x64 0x66 0x63 0x60 0x5f 0x5f 0x5f 0x5f 0x5d 0x5d 0x5d 0x5d 0x5f 0x5f 0x5f 0x5f 0x60 0x63 0x64 0x68 0x67 0x64 0x64 0x64 0x63 0x64 0x63 0x63 0x63 0x63 0x64 0x64 0x64 0x64 0x66 0x67 0x68 0x68 0x67 0x64 0x64 0x64 0x63 0x63 0x63 0x63 0x63 0x63 0x63 0x63 0x64 0x64 0x64 0x66 0x68 0x6b 0x68 0x67 0x66 0x66 0x66 0x66 0x66 0x66 0x66 0x66 0x66 0x66 0x66 0x66 0x67 0x68 0x6a 0x6b 0x6a 0x67 0x67 0x67 0x67 0x67 0x67 0x67 0x66 0x66 0x66 0x66 0x66 0x67 0x67 0x68 0x6a 0x6d 0x6a 0x68 0x68 0x68 0x68 0x68 0x68 0x68 0x68 0x68 0x68 0x68 0x68 0x68 0x68 0x6a 0x6d 0x6e 0x6d 0x6a 0x6a 0x6a 0x6a 0x6a 0x6a 0x6b 0x6a 0x6a 0x6a 0x6a 0x68 0x6a 0x6a 0x6b 0x6d 0x75 0x6f 0x6d 0x6e 0x6d 0x6d 0x6e 0x6e 0x6e 0x6b 0x6b 0x6b 0x6b 0x6b 0x6b 0x6b 0x6d 0x72 0x71 0x6d 0x6b 0x6b 0x6b 0x6b 0x6b 0x6b 0x6e 0x6d 0x6b 0x6b 0x6b 0x6b 0x6b 0x6b 0x6e 0x71 0x72 0x6f 0x6e 0x6e 0x6e 0x6e 0x6e 0x6e 0x6f 0x6e 0x6d 0x6d 0x6d 0x6d 0x6d 0x6d 0x6e 0x72 0x73 0x72 0x71 0x71 0x71 0x71 0x72 0x72 0x72 0x6f 0x6e 0x6e 0x6e 0x6e 0x6e 0x6d 0x6f 0x73 0x13a 0x13a 0x13a>;
					PS_Config_Lmt_FW_Diff_N = <0xffffffce 0xffffffce 0xffffffce 0xffffffce 0xffffffce 0xffffffce 0xffffffce 0xffffffce 0xffff0001 0xffff0001 0xffffffce 0xffffffce 0xffffffce 0xffffffce 0xffffffce 0xffffffce 0xffffffce 0xffffffce 0xffffffce 0xffffffce 0xffffffce 0xffffffce 0xffffffce 0xffffffce 0xffffffce 0xffffffce 0xffffffce 0xffffffce 0xffffffce 0xffffffce 0xffffffce 0xffffffce 0xffffffce 0xffffffce 0xffffffce 0xffffffce 0xffffffce 0xffffffce 0xffffffce 0xffffffce 0xffffffce 0xffffffce 0xffffffce 0xffffffce 0xffffffce 0xffffffce 0xffffffce 0xffffffce 0xffffffce 0xffffffce 0xffffffce 0xffffffce 0xffffffce 0xffffffce 0xffffffce 0xffffffce 0xffffffce 0xffffffce 0xffffffce 0xffffffce 0xffffffce 0xffffffce 0xffffffce 0xffffffce 0xffffffce 0xffffffce 0xffffffce 0xffffffce 0xffffffce 0xffffffce 0xffffffce 0xffffffce 0xffffffce 0xffffffce 0xffffffce 0xffffffce 0xffffffce 0xffffffce 0xffffffce 0xffffffce 0xffffffce 0xffffffce 0xffffffce 0xffffffce 0xffffffce 0xffffffce 0xffffffce 0xffffffce 0xffffffce 0xffffffce 0xffffffce 0xffffffce 0xffffffce 0xffffffce 0xffffffce 0xffffffce 0xffffffce 0xffffffce 0xffffffce 0xffffffce 0xffffffce 0xffffffce 0xffffffce 0xffffffce 0xffffffce 0xffffffce 0xffffffce 0xffffffce 0xffffffce 0xffffffce 0xffffffce 0xffffffce 0xffffffce 0xffffffce 0xffffffce 0xffffffce 0xffffffce 0xffffffce 0xffffffce 0xffffffce 0xffffffce 0xffffffce 0xffffffce 0xffffffce 0xffffffce 0xffffffce 0xffffffce 0xffffffce 0xffffffce 0xffffffce 0xffffffce 0xffffffce 0xffffffce 0xffffffce 0xffffffce 0xffffffce 0xffffffce 0xffffffce 0xffffffce 0xffffffce 0xffffffce 0xffffffce 0xffffffce 0xffffffce 0xffffffce 0xffffffce 0xffffffce 0xffffffce 0xffffffce 0xffffffce 0xffffffce 0xffffffce 0xffffffce 0xffffffce 0xffffffce 0xffffffce 0xffffffce 0xffffffce 0xffffffce 0xffffffce 0xffffffce 0xffffffce 0xffffffce 0xffffffce 0xffffffce 0xffffffce 0xffffffce 0xffffffce 0xffffffce 0xffffffce 0xffffffce 0xffffffce 0xffffffce 0xffffffce 0xffffffce 0xffffffce 0xffffffce 0xffffffce 0xffffffce 0xffffffce 0xffffffce 0xffffffce 0xffffffce 0xffffffce 0xffffffce 0xffffffce 0xffffffce 0xffffffce 0xffffffce 0xffffffce 0xffffffce 0xffffffce 0xffffffce 0xffffffce 0xffffffce 0xffffffce 0xffffffce 0xffffffce 0xffffffce 0xffffffce 0xffffffce 0xffffffce 0xffffffce 0xffffffce 0xffffffce 0xffffffce 0xffffffce 0xffffffce 0xffffffce 0xffffffce 0xffffffce 0xffffffce 0xffffffce 0xffffffce 0xffffffce 0xffffffce 0xffffffce 0xffffffce 0xffffffce 0xffffffce 0xffffffce 0xffffffce 0xffffffce 0xffffffce 0xffffffce 0xffffffce 0xffffffce 0xffffffce 0xffffffce 0xffffffce 0xffffffce 0xffffffce 0xffffffce 0xffffffce 0xffffffce 0xffffffce 0xffffffce 0xffffffce 0xffffffce 0xffffffce 0xffffffce 0xffffffce 0xffffffce 0xffffffce 0xffffffce 0xffffffce 0xffffffce 0xffffffce 0xffffffce 0xffffffce 0xffffffce 0xffffffce 0xffffffce 0xffffffce 0xffffffce 0xffffffce 0xffffffce 0xffffffce 0xffffffce 0xffffffce 0xffffffce 0xffffffce 0xffffffce 0xffffffce 0xffffffce 0xffffffce 0xffffffce 0xffffffce 0xffffffce 0xffffffce 0xffffffce 0xffffffce 0xffffffce 0xffffffce 0xffffffce 0xffffffce 0xffffffce 0xffffffce 0xffffffce 0xffffffce 0xffffffce 0xffffffce 0xffffffce 0xffffffce 0xffffffce 0xffffffce 0xffffffce 0xffffffce 0xffffffce 0xffffffce 0xffffffce 0xffffffce 0xffffffce 0xffffffce 0xffffffce 0xffffffce 0xffffffce 0xffffffce 0xffffffce 0xffffffce 0xffffffce 0xffffffce 0xffffffce 0xffffffce 0xffffffce 0xffffffce 0xffffffce 0xffffffce 0xffffffce 0xffffffce 0xffffffce 0xffffffce 0xffffffce 0xffffffce 0xffffffce 0xffffffce 0xffffffce 0xffffffce 0xffffffce 0xffffffce 0xffffffce 0xffffffce 0xffffffce 0xffffffce 0xffffffce 0xffffffce 0xffffffce 0xffffffce 0xffffffce 0xffffffce 0xffffffce 0xffffffce 0xffffffce 0xffffffce 0xffffffce 0xffffffce 0xffffffce 0xffffffce 0xffffffce 0xffffffce 0xffffffce 0xffffffce 0xffffffce 0xffffffce 0xffffffce 0xffffffce 0xffffffce 0xffffffce 0xffffffce 0xffffffce 0xffffffce 0xffffffce 0xffffffce 0xffffffce 0xffffffce 0xffffffce 0xffffffce 0xffffffce 0xffffffce 0xffffffce 0xffffffce 0xffffffce 0xffffffce 0xffffffce 0xffffffce 0xffffffce 0xffffffce 0xffffffce 0xffffffce 0xffffffce 0xffffffce 0xffffffce 0xffffffce 0xffffffce 0xffffffce 0xffffffce 0xffffffce 0xffffffce 0xffffffce 0xffffffce 0xffffffce 0xffffffce 0xffffffce 0xffffffce 0xffffffce 0xffffffce 0xffffffce 0xffffffce 0xffffffce 0xffffffce 0xffffffce 0xffffffce 0xffffffce 0xffffffce 0xffffffce 0xffffffce 0xffffffce 0xffffffce 0xffffffce 0xffffffce 0xffffffce 0xffffffce 0xffffffce 0xffffffce 0xffffffce 0xffffffce 0xffffffce 0xffffffce 0xffffffce 0xffffffce 0xffffffce 0xffffffce 0xffffffce 0xffffffce 0xffffffce 0xffffffce 0xffffffce 0xffffffce 0xffffffce 0xffffffce 0xffffffce 0xffffffce 0xffffffce 0xffffffce 0xffffffce 0xffffffce 0xffffffce 0xffffffce 0xffffffce 0xffffffce 0xffffffce 0xffffffce 0xffffffce 0xffffffce 0xffffffce 0xffffffce 0xffffffce 0xffffffce 0xffffffce 0xffffffce 0xffffffce 0xffffffce 0xffffffce 0xffffffce 0xffffffce 0xffffffce 0xffffffce 0xffffffce 0xffffffce 0xffffffce 0xffffffce 0xffffffce 0xffffffce 0xffffffce 0xffffffce 0xffffffce 0xffffffce 0xffffffce 0xffffffce 0xffffffce 0xffffffce 0xffffffce 0xffffffce 0xffffffce 0xffffffce 0xffffffce 0xffffffce 0xffffffce 0xffffffce 0xffffffce 0xffffffce 0xffffffce 0xffffffce 0xffffffce 0xffffffce 0xffffffce 0xffffffce 0xffffffce 0xffffffce 0xffffffce 0xffffffce 0xffffffce 0xffffffce 0xffffffce 0xffffffce 0xffffffce 0xffffffce 0xffffffce 0xffffffce 0xffffffce 0xffffffce 0xffffffce 0xffffffce 0xffffffce 0xffffffce 0xffffffce 0xffffffce 0xffffffce 0xffffffce 0xffffffce 0xffffffce 0xffffffce 0xffffffce 0xffffffce 0xffffffce 0xffffffce 0xffffffce 0xffffffce 0xffffffce 0xffffffce 0xffffffce 0xffffffce 0xffffffce 0xffffffce 0xffffffce 0xffffffce 0xffffffce 0xffffffce 0xffffffce 0xffffffce 0xffffffce 0xffffffce 0xffffffce 0xffffffce 0xffffffce 0xffffffce 0xffffffce 0xffffffce 0xffffffce 0xffffffce 0xffffffce 0xffffffce 0xffffffce 0xffffffce 0xffffffce 0xffffffce 0xffffffce 0xffffffce 0xffffffce 0xffffffce 0xffffffce 0xffffffce 0xffffffce 0xffffffce 0xffffffce 0xffffffce 0xffffffce 0xffffffce 0xffffffce 0xffffffce 0xffffffce 0xffffffce 0xffffffce 0xffffffce 0xffffffce 0xffffffce 0xffffffce 0xffffffce 0xffffffce 0xffffffce 0xffffffce 0xffffffce 0xffffffce 0xffffffce 0xffffffce 0xffffffce 0xffffffce 0xffffffce 0xffffffce 0xffffffce 0xffffffce 0xffffffce 0xffffffce 0xffffffce 0xffffffce 0xffffffce 0xffffffb5 0xffffffb5 0xffffffb5>;
					PS_Config_Lmt_FW_Diff_P = <0x32 0x32 0x32 0x32 0x32 0x32 0x32 0x32 0xffff 0xffff 0x32 0x32 0x32 0x32 0x32 0x32 0x32 0x32 0x32 0x32 0x32 0x32 0x32 0x32 0x32 0x32 0x32 0x32 0x32 0x32 0x32 0x32 0x32 0x32 0x32 0x32 0x32 0x32 0x32 0x32 0x32 0x32 0x32 0x32 0x32 0x32 0x32 0x32 0x32 0x32 0x32 0x32 0x32 0x32 0x32 0x32 0x32 0x32 0x32 0x32 0x32 0x32 0x32 0x32 0x32 0x32 0x32 0x32 0x32 0x32 0x32 0x32 0x32 0x32 0x32 0x32 0x32 0x32 0x32 0x32 0x32 0x32 0x32 0x32 0x32 0x32 0x32 0x32 0x32 0x32 0x32 0x32 0x32 0x32 0x32 0x32 0x32 0x32 0x32 0x32 0x32 0x32 0x32 0x32 0x32 0x32 0x32 0x32 0x32 0x32 0x32 0x32 0x32 0x32 0x32 0x32 0x32 0x32 0x32 0x32 0x32 0x32 0x32 0x32 0x32 0x32 0x32 0x32 0x32 0x32 0x32 0x32 0x32 0x32 0x32 0x32 0x32 0x32 0x32 0x32 0x32 0x32 0x32 0x32 0x32 0x32 0x32 0x32 0x32 0x32 0x32 0x32 0x32 0x32 0x32 0x32 0x32 0x32 0x32 0x32 0x32 0x32 0x32 0x32 0x32 0x32 0x32 0x32 0x32 0x32 0x32 0x32 0x32 0x32 0x32 0x32 0x32 0x32 0x32 0x32 0x32 0x32 0x32 0x32 0x32 0x32 0x32 0x32 0x32 0x32 0x32 0x32 0x32 0x32 0x32 0x32 0x32 0x32 0x32 0x32 0x32 0x32 0x32 0x32 0x32 0x32 0x32 0x32 0x32 0x32 0x32 0x32 0x32 0x32 0x32 0x32 0x32 0x32 0x32 0x32 0x32 0x32 0x32 0x32 0x32 0x32 0x32 0x32 0x32 0x32 0x32 0x32 0x32 0x32 0x32 0x32 0x32 0x32 0x32 0x32 0x32 0x32 0x32 0x32 0x32 0x32 0x32 0x32 0x32 0x32 0x32 0x32 0x32 0x32 0x32 0x32 0x32 0x32 0x32 0x32 0x32 0x32 0x32 0x32 0x32 0x32 0x32 0x32 0x32 0x32 0x32 0x32 0x32 0x32 0x32 0x32 0x32 0x32 0x32 0x32 0x32 0x32 0x32 0x32 0x32 0x32 0x32 0x32 0x32 0x32 0x32 0x32 0x32 0x32 0x32 0x32 0x32 0x32 0x32 0x32 0x32 0x32 0x32 0x32 0x32 0x32 0x32 0x32 0x32 0x32 0x32 0x32 0x32 0x32 0x32 0x32 0x32 0x32 0x32 0x32 0x32 0x32 0x32 0x32 0x32 0x32 0x32 0x32 0x32 0x32 0x32 0x32 0x32 0x32 0x32 0x32 0x32 0x32 0x32 0x32 0x32 0x32 0x32 0x32 0x32 0x32 0x32 0x32 0x32 0x32 0x32 0x32 0x32 0x32 0x32 0x32 0x32 0x32 0x32 0x32 0x32 0x32 0x32 0x32 0x32 0x32 0x32 0x32 0x32 0x32 0x32 0x32 0x32 0x32 0x32 0x32 0x32 0x32 0x32 0x32 0x32 0x32 0x32 0x32 0x32 0x32 0x32 0x32 0x32 0x32 0x32 0x32 0x32 0x32 0x32 0x32 0x32 0x32 0x32 0x32 0x32 0x32 0x32 0x32 0x32 0x32 0x32 0x32 0x32 0x32 0x32 0x32 0x32 0x32 0x32 0x32 0x32 0x32 0x32 0x32 0x32 0x32 0x32 0x32 0x32 0x32 0x32 0x32 0x32 0x32 0x32 0x32 0x32 0x32 0x32 0x32 0x32 0x32 0x32 0x32 0x32 0x32 0x32 0x32 0x32 0x32 0x32 0x32 0x32 0x32 0x32 0x32 0x32 0x32 0x32 0x32 0x32 0x32 0x32 0x32 0x32 0x32 0x32 0x32 0x32 0x32 0x32 0x32 0x32 0x32 0x32 0x32 0x32 0x32 0x32 0x32 0x32 0x32 0x32 0x32 0x32 0x32 0x32 0x32 0x32 0x32 0x32 0x32 0x32 0x32 0x32 0x32 0x32 0x32 0x32 0x32 0x32 0x32 0x32 0x32 0x32 0x32 0x32 0x32 0x32 0x32 0x32 0x32 0x32 0x32 0x32 0x32 0x32 0x32 0x32 0x32 0x32 0x32 0x32 0x32 0x32 0x32 0x32 0x32 0x32 0x32 0x32 0x32 0x32 0x32 0x32 0x32 0x32 0x32 0x32 0x32 0x32 0x32 0x32 0x32 0x32 0x32 0x32 0x32 0x32 0x32 0x32 0x32 0x32 0x32 0x32 0x32 0x32 0x32 0x32 0x32 0x32 0x32 0x32 0x32 0x32 0x32 0x32 0x32 0x32 0x32 0x32 0x32 0x32 0x32 0x32 0x32 0x32 0x32 0x32 0x32 0x4b 0x4b 0x4b>;
					PS_Config_Lmt_FW_Rawdata_N = <0x1e1 0x1df 0x1e0 0x1e1 0x1e2 0x1e6 0x1df 0x1e1 0xffff0001 0xffff0001 0x1e4 0x1e2 0x1e0 0x1e1 0x1df 0x1e1 0x1df 0x1e0 0x1db 0x1de 0x1e0 0x1e0 0x1e1 0x1dd 0x1dd 0x1e1 0x1db 0x1e1 0x1df 0x1e0 0x1e3 0x1dd 0x1e4 0x1e1 0x1e3 0x1df 0x1e1 0x1de 0x1df 0x1e1 0x1e4 0x1df 0x1dc 0x1de 0x1de 0x1e3 0x1e0 0x1e6 0x1e6 0x1dd 0x1e1 0x1e3 0x1e2 0x1e0 0x1da 0x1e1 0x1e3 0x1de 0x1e1 0x1de 0x1e1 0x1e2 0x1e4 0x1e0 0x1df 0x1e1 0x1e0 0x1e1 0x1e0 0x1e1 0x1e1 0x1e5 0x1e0 0x1e0 0x1e1 0x1e1 0x1e1 0x1e0 0x1dd 0x1df 0x1e0 0x1de 0x1e3 0x1e0 0x1df 0x1e2 0x1db 0x1df 0x1de 0x1e0 0x1de 0x1db 0x1e0 0x1db 0x1e4 0x1df 0x1e2 0x1e2 0x1e0 0x1df 0x1e0 0x1dd 0x1de 0x1e0 0x1e0 0x1e2 0x1df 0x1e1 0x1e3 0x1df 0x1dd 0x1e4 0x1df 0x1dc 0x1df 0x1de 0x1df 0x1dc 0x1da 0x1df 0x1e4 0x1dd 0x1e1 0x1de 0x1dd 0x1db 0x1e0 0x1df 0x1db 0x1e3 0x1e1 0x1de 0x1e0 0x1e0 0x1df 0x1e5 0x1e2 0x1e0 0x1e0 0x1e2 0x1e3 0x1db 0x1e2 0x1e0 0x1e4 0x1de 0x1e6 0x1e1 0x1dd 0x1e6 0x1de 0x1df 0x1e1 0x1e1 0x1e2 0x1dc 0x1e1 0x1de 0x1e0 0x1e1 0x1de 0x1df 0x1e4 0x1e0 0x1e4 0x1e1 0x1da 0x1e6 0x1db 0x1e3 0x1d8 0x1e0 0x1e7 0x1e1 0x1de 0x1e0 0x1de 0x1dd 0x1e2 0x1e1 0x1de 0x1e1 0x1e6 0x1df 0x1de 0x1e2 0x1e1 0x1e0 0x1e4 0x1e3 0x1dc 0x1dc 0x1dc 0x1dc 0x1e3 0x1e3 0x1e0 0x1df 0x1d9 0x1dd 0x1e1 0x1e0 0x1de 0x1e1 0x1e5 0x1db 0x1e4 0x1de 0x1e0 0x1e1 0x1e0 0x1e0 0x1e0 0x1e5 0x1de 0x1da 0x1dd 0x1e0 0x1e1 0x1df 0x1e0 0x1e3 0x1e1 0x1de 0x1e2 0x1e4 0x1de 0x1e0 0x1e4 0x1e1 0x1dd 0x1d8 0x1e6 0x1e4 0x1e0 0x1e3 0x1e0 0x1e1 0x1df 0x1dd 0x1de 0x1e2 0x1e1 0x1e4 0x1e2 0x1de 0x1e1 0x1e6 0x1dd 0x1e4 0x1e3 0x1e0 0x1e0 0x1dd 0x1dc 0x1df 0x1e5 0x1e1 0x1e0 0x1e3 0x1e3 0x1e0 0x1e6 0x1d8 0x1db 0x1de 0x1e1 0x1e0 0x1db 0x1df 0x1db 0x1e0 0x1e2 0x1de 0x1de 0x1e4 0x1e0 0x1de 0x1e1 0x1e1 0x1e3 0x1e0 0x1de 0x1dc 0x1e1 0x1dd 0x1de 0x1e0 0x1e6 0x1de 0x1dd 0x1e0 0x1da 0x1e4 0x1e1 0x1e1 0x1e1 0x1de 0x1e1 0x1e3 0x1de 0x1e5 0x1e0 0x1df 0x1e4 0x1de 0x1e2 0x1e6 0x1e1 0x1e0 0x1df 0x1db 0x1e2 0x1e1 0x1db 0x1df 0x1de 0x1dd 0x1e2 0x1e0 0x1e0 0x1db 0x1e7 0x1e0 0x1e4 0x1db 0x1e1 0x1dd 0x1e4 0x1e4 0x1dc 0x1e5 0x1e1 0x1e1 0x1e4 0x1db 0x1df 0x1da 0x1e1 0x1e0 0x1d8 0x1df 0x1de 0x1e0 0x1e6 0x1db 0x1d7 0x1e1 0x1e0 0x1e2 0x1e1 0x1e0 0x1de 0x1e2 0x1e3 0x1db 0x1dd 0x1e0 0x1e7 0x1e1 0x1de 0x1e0 0x1df 0x1da 0x1e1 0x1de 0x1e0 0x1dd 0x1de 0x1de 0x1dd 0x1e2 0x1e4 0x1e6 0x1e0 0x1d9 0x1dd 0x1dd 0x1e1 0x1e4 0x1de 0x1e0 0x1df 0x1df 0x1da 0x1de 0x1e1 0x1e1 0x1de 0x1dd 0x1e0 0x1de 0x1e4 0x1dd 0x1e4 0x1de 0x1dc 0x1e7 0x1de 0x1e4 0x1e3 0x1df 0x1e7 0x1e0 0x1de 0x1dd 0x1df 0x1e2 0x1e0 0x1e1 0x1e2 0x1e1 0x1e0 0x1e6 0x1e0 0x1e1 0x1e4 0x1df 0x1dd 0x1dc 0x1de 0x1e5 0x1e1 0x1e1 0x1de 0x1df 0x1e3 0x1db 0x1da 0x1e6 0x1e1 0x1e4 0x1e6 0x1db 0x1e0 0x1e2 0x1df 0x1db 0x1dc 0x1d9 0x1dc 0x1dd 0x1df 0x1df 0x1e0 0x1dd 0x1df 0x1de 0x1e2 0x1df 0x1df 0x1dc 0x1e0 0x1dd 0x1dc 0x1e0 0x1df 0x1e0 0x1dd 0x1e1 0x1e3 0x1e3 0x1e4 0x1dd 0x1dc 0x1de 0x1e3 0x1e0 0x1de 0x1e1 0x1db 0x1e0 0x1df 0x1de 0x1e0 0x1e2 0x1e1 0x1e0 0x1e1 0x1db 0x1dc 0x1dd 0x1e0 0x1e2 0x1df 0x1e3 0x1db 0x1e4 0x1e3 0x1de 0x1e3 0x1e3 0x1e0 0x1e0 0x1de 0x1e1 0x1dd 0x1de 0x1e4 0x1e4 0x1df 0x1e0 0x1d7 0x1e1 0x1e0 0x1e1 0x1e0 0x1e4 0x1e1 0x1e3 0x1de 0x1e1 0x1e3 0x1e4 0x1e0 0x1da 0x1d8 0x1de 0x1e5 0x1e5 0x1e0 0x1e5 0x1de 0x1e1 0x1dd 0x1d9 0x1dd 0x1e2 0x1e9 0x1e9 0x1dc 0x1e3 0x1df 0x1e2 0x1de 0x1e1 0x1e0 0x1e0 0x1e3 0x1e1 0x1e3 0x1e1 0x1e0 0x1dd 0x1e1 0x1e2 0x1e4 0x1e1 0x1e0 0x1e1 0x1e1 0x1e1 0x1e0 0x1e2 0x1de 0x1e1 0x1de 0x1e3 0x1dd 0x1db 0x1e1 0x1e1 0x1de 0x1e3 0x1df 0x1dd 0x1df 0x1dd 0x1de 0x1dd 0x1e0 0x1e1 0x1e5 0x1df 0x1dd 0x1e2 0xf0 0xf0 0xf0>;
					PS_Config_Lmt_FW_Rawdata_P = <0x464 0x45e 0x461 0x464 0x465 0x46e 0x45e 0x462 0xffff 0xffff 0x469 0x465 0x461 0x464 0x45e 0x464 0x45e 0x460 0x456 0x45b 0x460 0x461 0x462 0x459 0x459 0x462 0x454 0x462 0x45e 0x461 0x467 0x45a 0x46b 0x464 0x468 0x45e 0x464 0x45b 0x45e 0x462 0x469 0x45e 0x457 0x45d 0x45d 0x468 0x460 0x46e 0x46f 0x459 0x462 0x468 0x465 0x460 0x453 0x464 0x468 0x45d 0x464 0x45b 0x462 0x465 0x46b 0x461 0x45e 0x462 0x461 0x464 0x460 0x464 0x464 0x46c 0x461 0x461 0x464 0x462 0x464 0x461 0x45a 0x45e 0x461 0x45d 0x468 0x460 0x45e 0x465 0x456 0x45e 0x45b 0x460 0x45b 0x454 0x460 0x456 0x469 0x45e 0x465 0x465 0x460 0x45e 0x460 0x45a 0x45b 0x461 0x460 0x465 0x45e 0x464 0x468 0x45e 0x459 0x469 0x45e 0x457 0x45e 0x45b 0x45e 0x457 0x453 0x45e 0x46b 0x45a 0x464 0x45b 0x45a 0x456 0x460 0x45e 0x456 0x467 0x462 0x45d 0x461 0x461 0x45e 0x46c 0x465 0x461 0x461 0x465 0x467 0x456 0x465 0x461 0x46b 0x45d 0x46f 0x464 0x459 0x46e 0x45b 0x45e 0x462 0x464 0x465 0x457 0x462 0x45b 0x461 0x464 0x45d 0x45e 0x46b 0x460 0x46b 0x462 0x453 0x46e 0x456 0x468 0x44f 0x460 0x470 0x462 0x45d 0x460 0x45b 0x45a 0x465 0x462 0x45d 0x464 0x46e 0x45e 0x45d 0x465 0x462 0x461 0x469 0x467 0x457 0x457 0x457 0x457 0x468 0x468 0x461 0x45e 0x450 0x459 0x464 0x461 0x45b 0x464 0x46c 0x456 0x46b 0x45d 0x460 0x462 0x460 0x461 0x460 0x46c 0x45d 0x452 0x45a 0x460 0x464 0x45e 0x461 0x468 0x462 0x45b 0x465 0x46b 0x45b 0x460 0x469 0x464 0x45a 0x44d 0x46f 0x46b 0x460 0x467 0x461 0x464 0x45e 0x45a 0x45b 0x465 0x462 0x469 0x465 0x45d 0x464 0x46e 0x45a 0x46b 0x467 0x460 0x461 0x45a 0x457 0x45e 0x46c 0x462 0x461 0x467 0x468 0x461 0x46e 0x44d 0x456 0x45b 0x464 0x461 0x456 0x45e 0x454 0x461 0x465 0x45d 0x45d 0x469 0x460 0x45d 0x464 0x464 0x468 0x460 0x45d 0x457 0x462 0x45a 0x45d 0x460 0x46f 0x45d 0x459 0x461 0x453 0x469 0x462 0x464 0x464 0x45d 0x462 0x468 0x45b 0x46c 0x460 0x45e 0x46b 0x45d 0x465 0x46f 0x462 0x460 0x45e 0x454 0x465 0x462 0x454 0x45e 0x45b 0x459 0x465 0x460 0x460 0x454 0x470 0x460 0x469 0x456 0x462 0x459 0x46b 0x469 0x457 0x46c 0x462 0x464 0x46b 0x456 0x45e 0x453 0x462 0x460 0x44f 0x45e 0x45b 0x460 0x46e 0x456 0x44c 0x462 0x461 0x465 0x462 0x460 0x45b 0x465 0x467 0x454 0x45a 0x460 0x470 0x462 0x45b 0x460 0x45e 0x453 0x462 0x45d 0x461 0x459 0x45d 0x45b 0x459 0x465 0x46b 0x46f 0x461 0x450 0x45a 0x459 0x462 0x469 0x45d 0x461 0x45e 0x45e 0x452 0x45b 0x462 0x462 0x45b 0x459 0x461 0x45d 0x46b 0x45a 0x469 0x45d 0x457 0x470 0x45b 0x46b 0x467 0x45e 0x470 0x461 0x45b 0x45a 0x45e 0x465 0x460 0x462 0x465 0x464 0x460 0x46e 0x460 0x464 0x46b 0x45e 0x45a 0x457 0x45b 0x46c 0x464 0x462 0x45d 0x45e 0x467 0x456 0x453 0x46f 0x464 0x469 0x46f 0x456 0x461 0x465 0x45e 0x456 0x457 0x450 0x457 0x459 0x45e 0x45e 0x461 0x45a 0x45e 0x45b 0x465 0x45e 0x45e 0x457 0x460 0x45a 0x457 0x461 0x45e 0x460 0x459 0x464 0x467 0x467 0x46b 0x459 0x457 0x45d 0x468 0x460 0x45d 0x462 0x456 0x461 0x45e 0x45d 0x461 0x465 0x464 0x461 0x464 0x454 0x457 0x459 0x460 0x465 0x45e 0x467 0x454 0x469 0x468 0x45b 0x467 0x467 0x460 0x461 0x45b 0x462 0x45a 0x45d 0x469 0x469 0x45e 0x461 0x44b 0x464 0x461 0x462 0x460 0x469 0x464 0x468 0x45d 0x462 0x467 0x469 0x460 0x453 0x44d 0x45d 0x46c 0x46c 0x461 0x46c 0x45d 0x464 0x459 0x450 0x45a 0x465 0x475 0x476 0x457 0x467 0x45e 0x465 0x45d 0x462 0x461 0x460 0x468 0x464 0x467 0x464 0x461 0x459 0x464 0x465 0x469 0x462 0x461 0x462 0x464 0x462 0x460 0x465 0x45d 0x462 0x45d 0x468 0x459 0x454 0x462 0x462 0x45b 0x467 0x45e 0x459 0x45e 0x459 0x45b 0x459 0x460 0x464 0x46c 0x45e 0x459 0x465 0xf00 0xf00 0xf00>;
					PS_Config_Lmt_Open_Rawdata_N = <0x44e 0x44b 0x436 0x41d 0x406 0x3f9 0x3e1 0x3d6 0xffff0001 0xffff0001 0x375 0x37c 0x389 0x391 0x39f 0x3a9 0x3b6 0x3c4 0x414 0x417 0x40d 0x3fd 0x3ee 0x3e4 0x3dd 0x3d3 0x3ca 0x3e5 0x3ea 0x3ef 0x3f1 0x3f5 0x3f8 0x3f7 0x400 0x412 0x466 0x469 0x45f 0x44e 0x43f 0x432 0x429 0x420 0x414 0x3b2 0x3b5 0x3b8 0x3bd 0x3c2 0x3c6 0x3c8 0x3cd 0x3df 0x42a 0x436 0x42d 0x420 0x412 0x405 0x3fd 0x3f3 0x3ea 0x3fa 0x3fd 0x402 0x407 0x40b 0x40e 0x410 0x417 0x426 0x468 0x477 0x46a 0x45b 0x448 0x43a 0x433 0x426 0x41d 0x3d6 0x3dc 0x3de 0x3e3 0x3e5 0x3e7 0x3eb 0x3f3 0x402 0x43d 0x44f 0x441 0x432 0x423 0x415 0x40e 0x404 0x3fb 0x429 0x42f 0x433 0x437 0x43a 0x43e 0x441 0x447 0x455 0x46a 0x464 0x453 0x446 0x433 0x428 0x426 0x41d 0x411 0x3eb 0x3ef 0x3f4 0x3f3 0x3f9 0x3fc 0x3fc 0x40b 0x3e7 0x429 0x420 0x411 0x403 0x3f2 0x3e7 0x3e5 0x3db 0x3d0 0x43b 0x43f 0x444 0x442 0x44b 0x450 0x452 0x460 0x447 0x484 0x478 0x468 0x45d 0x44b 0x43d 0x43d 0x42f 0x424 0x417 0x41d 0x41f 0x41e 0x421 0x426 0x425 0x433 0x41a 0x45a 0x44b 0x43c 0x42f 0x41d 0x40f 0x40e 0x402 0x3f9 0x454 0x45a 0x460 0x45d 0x461 0x467 0x468 0x473 0x461 0x4b7 0x4a5 0x493 0x486 0x476 0x46a 0x465 0x45b 0x453 0x428 0x42c 0x433 0x432 0x437 0x43e 0x43b 0x44a 0x43d 0x483 0x472 0x463 0x459 0x448 0x43d 0x438 0x42c 0x423 0x495 0x499 0x49f 0x49e 0x4a2 0x4a8 0x4a7 0x4b6 0x4ae 0x4e5 0x4d1 0x4c2 0x4b5 0x4a5 0x498 0x492 0x489 0x47c 0x468 0x46b 0x472 0x46c 0x470 0x475 0x471 0x47e 0x47a 0x4aa 0x498 0x488 0x47b 0x46b 0x45f 0x45c 0x453 0x447 0x486 0x488 0x48c 0x48a 0x48f 0x492 0x491 0x49e 0x49d 0x50e 0x4f9 0x4e8 0x4db 0x4cb 0x4bd 0x4ba 0x4ad 0x4a3 0x464 0x469 0x46e 0x46f 0x472 0x475 0x472 0x47e 0x485 0x4d1 0x4bc 0x4ab 0x4a1 0x490 0x483 0x480 0x474 0x46b 0x4b7 0x4ba 0x4bd 0x4bd 0x4c0 0x4c7 0x4c9 0x4d6 0x4e0 0x537 0x521 0x50e 0x501 0x4ef 0x4e1 0x4de 0x4d1 0x4c9 0x4a5 0x4a8 0x4ac 0x4a8 0x4ab 0x4b0 0x4b0 0x4be 0x4ca 0x503 0x4ee 0x4e0 0x4d2 0x4bc 0x4ae 0x4a8 0x49c 0x494 0x4dd 0x4e1 0x4e9 0x4e8 0x4ec 0x4ef 0x4ef 0x4fc 0x50b 0x55f 0x54d 0x53e 0x52f 0x51f 0x50f 0x505 0x4fb 0x4ee 0x4af 0x4ae 0x4b7 0x4b4 0x4b9 0x4bd 0x4ba 0x4c7 0x4d4 0x531 0x51c 0x50d 0x4fe 0x4ed 0x4e3 0x4dd 0x4d2 0x4c6 0x508 0x50b 0x513 0x510 0x511 0x517 0x516 0x524 0x537 0x58b 0x575 0x563 0x555 0x544 0x53b 0x538 0x52c 0x51c 0x4e5 0x4ea 0x4ef 0x4ed 0x4f2 0x4f5 0x4f3 0x500 0x513 0x558 0x543 0x537 0x526 0x516 0x50b 0x508 0x4fe 0x4f2 0x537 0x53d 0x543 0x540 0x546 0x54a 0x54c 0x556 0x56a 0x5c1 0x5ab 0x598 0x58c 0x57a 0x56c 0x567 0x55a 0x54f 0x517 0x522 0x526 0x527 0x52c 0x530 0x530 0x53b 0x54a 0x587 0x571 0x561 0x556 0x546 0x538 0x532 0x529 0x51f 0x569 0x571 0x573 0x573 0x576 0x57a 0x57d 0x589 0x59d 0x5f7 0x5e4 0x5d4 0x5c7 0x5b4 0x5a7 0x5a0 0x591 0x583 0x540 0x546 0x54d 0x54a 0x54a 0x550 0x54f 0x55c 0x56e 0x5bf 0x5ac 0x59d 0x58f 0x57d 0x571 0x56a 0x561 0x553 0x588 0x591 0x597 0x598 0x59d 0x5a1 0x59e 0x5a9 0x5ba 0x616 0x603 0x5f0 0x5e0 0x5cf 0x5c6 0x5bf 0x5b5 0x5a4 0x561 0x567 0x56d 0x570 0x572 0x573 0x575 0x584 0x597 0x60a 0x5f7 0x5ea 0x5db 0x5c8 0x5bd 0x5b7 0x5a9 0x59b 0x5bb 0x5bf 0x5c6 0x5c7 0x5c8 0x5ce 0x5ce 0x5d8 0x5eb 0x62a 0x65d 0x64d 0x63e 0x62a 0x619 0x612 0x604 0x5f2 0x595 0x59d 0x5a1 0x5a4 0x5a6 0x5aa 0x5aa 0x5bb 0x599 0x5c8 0x5fc 0x5f1 0x5e3 0x5d4 0x5c8 0x5c1 0x5b3 0x5a7 0x5e1 0x5e8 0x5f1 0x5f4 0x5f8 0x5fc 0x5fe 0x604 0x5dc 0x632 0x676 0x668 0x657 0x646 0x635 0x62e 0x620 0x612 0x5bc 0x5c4 0x5ca 0x5c8 0x5ca 0x5cf 0x5ce 0x5d9 0x5ad 0x600 0x64c 0x649 0x637 0x628 0x61c 0x615 0x60b 0x5fc 0x600 0x607 0x60c 0x60d 0x613 0x61b 0x61e 0x61d 0x5e0 0xfffffe01 0xfffffe01 0xfffffe01>;
					PS_Config_Lmt_Open_Rawdata_P = <0xa0b 0xa06 0x9d3 0x999 0x963 0x945 0x90e 0x8f5 0xffff 0xffff 0x811 0x821 0x840 0x852 0x874 0x88a 0x8a9 0x8cb 0x984 0x98b 0x974 0x94e 0x92b 0x914 0x904 0x8ee 0x8d7 0x918 0x922 0x92e 0x934 0x93c 0x943 0x942 0x957 0x97f 0xa43 0xa4c 0xa33 0xa0b 0x9e8 0x9ca 0x9b6 0x9a1 0x984 0x89f 0x8a8 0x8ad 0x8b9 0x8c5 0x8cf 0x8d3 0x8de 0x908 0x9b9 0x9d5 0x9c0 0x9a1 0x97f 0x962 0x94e 0x938 0x923 0x947 0x950 0x95b 0x966 0x96f 0x977 0x97b 0x98b 0x9af 0xa48 0xa6c 0xa4d 0xa2a 0x9ff 0x9dd 0x9cc 0x9ae 0x999 0x8f5 0x901 0x907 0x912 0x918 0x91c 0x924 0x937 0x95a 0x9e4 0xa0e 0x9ee 0x9cb 0x9a7 0x988 0x976 0x95f 0x94a 0x9b6 0x9c3 0x9cc 0x9d6 0x9dd 0x9e6 0x9ed 0x9fb 0xa1c 0xa4d 0xa3f 0xa18 0x9f9 0x9cc 0x9b3 0x9af 0x999 0x97e 0x924 0x92e 0x93b 0x938 0x946 0x94c 0x94d 0x96f 0x91c 0x9b6 0x9a1 0x97d 0x95e 0x935 0x91c 0x916 0x8ff 0x8e7 0x9e0 0x9e8 0x9f5 0x9f1 0xa06 0xa10 0xa15 0xa35 0x9fb 0xa8b 0xa6d 0xa49 0xa2e 0xa04 0x9e4 0x9e4 0x9c3 0x9a9 0x98b 0x999 0x99e 0x99b 0x9a4 0x9ae 0x9ac 0x9ce 0x993 0xa27 0xa06 0x9e3 0x9c3 0x99a 0x978 0x976 0x95b 0x945 0xa1b 0xa27 0xa37 0xa2e 0xa38 0xa46 0xa49 0xa62 0xa38 0xb02 0xad6 0xaae 0xa8f 0xa69 0xa4d 0xa42 0xa2a 0xa17 0x9b3 0x9bd 0x9cc 0x9cb 0x9d6 0x9e6 0x9e0 0xa02 0x9e4 0xa88 0xa61 0xa3e 0xa25 0x9fd 0x9e4 0x9d8 0x9bd 0x9a7 0xab1 0xaba 0xaca 0xac6 0xad1 0xadd 0xadc 0xafe 0xaeb 0xb6c 0xb3e 0xb1b 0xafc 0xad6 0xab8 0xaab 0xa96 0xa77 0xa49 0xa4f 0xa5f 0xa53 0xa5b 0xa66 0xa5e 0xa7d 0xa73 0xae3 0xab8 0xa93 0xa76 0xa50 0xa34 0xa2c 0xa17 0x9fc 0xa8e 0xa93 0xa9d 0xa99 0xaa4 0xaab 0xaa8 0xac7 0xac4 0xbcd 0xb9c 0xb73 0xb54 0xb30 0xb0e 0xb07 0xae9 0xad2 0xa3f 0xa4c 0xa57 0xa58 0xa5f 0xa66 0xa5f 0xa7d 0xa8c 0xb3d 0xb0d 0xae6 0xacd 0xaa5 0xa88 0xa81 0xa65 0xa50 0xb00 0xb07 0xb10 0xb0e 0xb17 0xb26 0xb2a 0xb49 0xb61 0xc2c 0xbf8 0xbcb 0xbad 0xb84 0xb62 0xb5b 0xb3d 0xb2c 0xad6 0xadd 0xae7 0xadd 0xae4 0xaf0 0xaf1 0xb11 0xb2d 0xbb2 0xb81 0xb60 0xb3f 0xb0d 0xaed 0xadd 0xac1 0xaaf 0xb5a 0xb62 0xb75 0xb73 0xb7c 0xb84 0xb84 0xba1 0xbc6 0xc8a 0xc60 0xc3d 0xc18 0xbf3 0xbce 0xbb6 0xb9f 0xb81 0xaee 0xaed 0xb02 0xafb 0xb06 0xb0e 0xb07 0xb26 0xb44 0xc1d 0xbec 0xbc9 0xba6 0xb7e 0xb68 0xb59 0xb41 0xb25 0xbbd 0xbc6 0xbd7 0xbd1 0xbd2 0xbe0 0xbdf 0xbff 0xc2c 0xcf0 0xcbc 0xc92 0xc72 0xc49 0xc34 0xc2d 0xc11 0xbed 0xb6c 0xb79 0xb83 0xb7e 0xb8a 0xb92 0xb8c 0xbab 0xbd7 0xc79 0xc48 0xc2b 0xc05 0xbdf 0xbc4 0xbbd 0xba6 0xb8a 0xc2c 0xc39 0xc47 0xc41 0xc4e 0xc59 0xc5d 0xc75 0xca3 0xd6d 0xd3a 0xd0d 0xcf1 0xcc7 0xca7 0xc9c 0xc7d 0xc63 0xbe2 0xbfb 0xc03 0xc06 0xc11 0xc1b 0xc1b 0xc36 0xc59 0xce6 0xcb2 0xc8e 0xc73 0xc4f 0xc2f 0xc1f 0xc0a 0xbf3 0xca0 0xcb2 0xcb8 0xcb7 0xcbf 0xcc9 0xcd0 0xcea 0xd19 0xdec 0xdbf 0xd99 0xd7b 0xd4f 0xd32 0xd20 0xcfe 0xcdc 0xc41 0xc4f 0xc5e 0xc57 0xc59 0xc67 0xc64 0xc83 0xcad 0xd68 0xd3d 0xd19 0xcf8 0xcce 0xcb4 0xca3 0xc8e 0xc6c 0xce9 0xcfe 0xd0b 0xd0f 0xd1a 0xd22 0xd1d 0xd35 0xd5d 0xe35 0xe08 0xddb 0xdb7 0xd8e 0xd79 0xd68 0xd51 0xd29 0xc8d 0xc9b 0xca9 0xcb0 0xcb5 0xcb8 0xcbc 0xcdf 0xd0c 0xe17 0xdec 0xdcd 0xdaa 0xd7d 0xd64 0xd56 0xd35 0xd16 0xd5f 0xd68 0xd79 0xd7b 0xd7f 0xd8b 0xd8d 0xda3 0xdd0 0xe62 0xed9 0xeb4 0xe91 0xe63 0xe3c 0xe2a 0xe09 0xddf 0xd08 0xd1a 0xd24 0xd29 0xd2e 0xd37 0xd39 0xd5f 0xd10 0xd7d 0xdf7 0xdde 0xdbc 0xd9b 0xd7d 0xd6d 0xd4e 0xd32 0xdb8 0xdc8 0xddd 0xde5 0xdef 0xdf7 0xdfb 0xe0b 0xdac 0xe75 0xf15 0xef3 0xecc 0xea3 0xe7c 0xe6b 0xe4b 0xe2a 0xd63 0xd75 0xd83 0xd7f 0xd83 0xd8e 0xd8b 0xda5 0xd3e 0xe00 0xeb1 0xeaa 0xe82 0xe5d 0xe43 0xe32 0xe1a 0xdf7 0xe01 0xe12 0xe1c 0xe20 0xe2e 0xe40 0xe47 0xe44 0xdb5 0x1400 0x1400 0x1400>;
					PS_Config_Lmt_Short_Rawdata_N = <0x2774 0x2774 0x2774 0x2774 0x2774 0x2774 0x2774 0x2774 0x2774 0x2774 0x2774 0x2774 0x2774 0x2774 0x2774 0x2774 0x2774 0x2774 0x2774 0x2774 0x2774 0x2774 0x2774 0x2774 0x2774 0x2774 0x2774 0x2774 0x2774 0x2774 0x2774 0x2774 0x2774 0x2774 0x2774 0x2774 0x2774 0x2774 0x2774 0x2774 0x2774 0x2774 0x2774 0x2774 0x2774 0x2774 0x2774 0x2774 0x2774 0x2774 0x2774 0x2774 0x2774 0x2774 0x2774 0x2774 0x2774 0x2774 0x2774 0x2774 0x2774 0x2774 0x2774 0x2774 0x2774 0x2774 0x2774 0x2774 0x2774 0x2774 0x2774 0x2774 0x2774 0x2774 0x2774 0x2774 0x2774 0x2774 0x2774 0x2774 0x2774 0x2774 0x2774 0x2774 0x2774 0x2774 0x2774 0x2774 0x2774 0x2774 0x2774 0x2774 0x2774 0x2774 0x2774 0x2774 0x2774 0x2774 0x2774 0x2774 0x2774 0x2774 0x2774 0x2774 0x2774 0x2774 0x2774 0x2774 0x2774 0x2774 0x2774 0x2774 0x2774 0x2774 0x2774 0x2774 0x2774 0x2774 0x2774 0x2774 0x2774 0x2774 0x2774 0x2774 0x2774 0x2774 0x2774 0x2774 0x2774 0x2774 0x2774 0x2774 0x2774 0x2774 0x2774 0x2774 0x2774 0x2774 0x2774 0x2774 0x2774 0x2774 0x2774 0x2774 0x2774 0x2774 0x2774 0x2774 0x2774 0x2774 0x2774 0x2774 0x2774 0x2774 0x2774 0x2774 0x2774 0x2774 0x2774 0x2774 0x2774 0x2774 0x2774 0x2774 0x2774 0x2774 0x2774 0x2774 0x2774 0x2774 0x2774 0x2774 0x2774 0x2774 0x2774 0x2774 0x2774 0x2774 0x2774 0x2774 0x2774 0x2774 0x2774 0x2774 0x2774 0x2774 0x2774 0x2774 0x2774 0x2774 0x2774 0x2774 0x2774 0x2774 0x2774 0x2774 0x2774 0x2774 0x2774 0x2774 0x2774 0x2774 0x2774 0x2774 0x2774 0x2774 0x2774 0x2774 0x2774 0x2774 0x2774 0x2774 0x2774 0x2774 0x2774 0x2774 0x2774 0x2774 0x2774 0x2774 0x2774 0x2774 0x2774 0x2774 0x2774 0x2774 0x2774 0x2774 0x2774 0x2774 0x2774 0x2774 0x2774 0x2774 0x2774 0x2774 0x2774 0x2774 0x2774 0x2774 0x2774 0x2774 0x2774 0x2774 0x2774 0x2774 0x2774 0x2774 0x2774 0x2774 0x2774 0x2774 0x2774 0x2774 0x2774 0x2774 0x2774 0x2774 0x2774 0x2774 0x2774 0x2774 0x2774 0x2774 0x2774 0x2774 0x2774 0x2774 0x2774 0x2774 0x2774 0x2774 0x2774 0x2774 0x2774 0x2774 0x2774 0x2774 0x2774 0x2774 0x2774 0x2774 0x2774 0x2774 0x2774 0x2774 0x2774 0x2774 0x2774 0x2774 0x2774 0x2774 0x2774 0x2774 0x2774 0x2774 0x2774 0x2774 0x2774 0x2774 0x2774 0x2774 0x2774 0x2774 0x2774 0x2774 0x2774 0x2774 0x2774 0x2774 0x2774 0x2774 0x2774 0x2774 0x2774 0x2774 0x2774 0x2774 0x2774 0x2774 0x2774 0x2774 0x2774 0x2774 0x2774 0x2774 0x2774 0x2774 0x2774 0x2774 0x2774 0x2774 0x2774 0x2774 0x2774 0x2774 0x2774 0x2774 0x2774 0x2774 0x2774 0x2774 0x2774 0x2774 0x2774 0x2774 0x2774 0x2774 0x2774 0x2774 0x2774 0x2774 0x2774 0x2774 0x2774 0x2774 0x2774 0x2774 0x2774 0x2774 0x2774 0x2774 0x2774 0x2774 0x2774 0x2774 0x2774 0x2774 0x2774 0x2774 0x2774 0x2774 0x2774 0x2774 0x2774 0x2774 0x2774 0x2774 0x2774 0x2774 0x2774 0x2774 0x2774 0x2774 0x2774 0x2774 0x2774 0x2774 0x2774 0x2774 0x2774 0x2774 0x2774 0x2774 0x2774 0x2774 0x2774 0x2774 0x2774 0x2774 0x2774 0x2774 0x2774 0x2774 0x2774 0x2774 0x2774 0x2774 0x2774 0x2774 0x2774 0x2774 0x2774 0x2774 0x2774 0x2774 0x2774 0x2774 0x2774 0x2774 0x2774 0x2774 0x2774 0x2774 0x2774 0x2774 0x2774 0x2774 0x2774 0x2774 0x2774 0x2774 0x2774 0x2774 0x2774 0x2774 0x2774 0x2774 0x2774 0x2774 0x2774 0x2774 0x2774 0x2774 0x2774 0x2774 0x2774 0x2774 0x2774 0x2774 0x2774 0x2774 0x2774 0x2774 0x2774 0x2774 0x2774 0x2774 0x2774 0x2774 0x2774 0x2774 0x2774 0x2774 0x2774 0x2774 0x2774 0x2774 0x2774 0x2774 0x2774 0x2774 0x2774 0x2774 0x2774 0x2774 0x2774 0x2774 0x2774 0x2774 0x2774 0x2774 0x2774 0x2774 0x2774 0x2774 0x2774 0x2774 0x2774 0x2774 0x2774 0x2774 0x2774 0x2774 0x2774 0x2774 0x2774 0x2774 0x2774 0x2774 0x2774 0x2774 0x2774 0x2774 0x2774 0x2774 0x2774 0x2774 0x2774 0x2774 0x2774 0x2774 0x2774 0x2774 0x2774 0x2774 0x2774 0x2774 0x2774 0x2774 0x2774 0x2774 0x2774 0x2774 0x2774 0x2774 0x2774 0x2774 0x2774 0x2774 0x2774 0x2774 0x2774 0x2774 0x2774 0x2774 0x2774 0x2774 0x2774 0x2774 0x2774 0x2774 0x2774 0x2774 0x2774 0x2774 0x2774 0x2774 0x2774 0x2774 0x2774 0x2774 0x2774 0x2774 0x2774 0x2774 0x2774 0x2774 0x2774 0x2774 0x2774 0x2774 0x2774 0x2774 0x2774 0x2774 0x2774 0x2774 0x2774 0x2774 0x2774 0x2774 0x2774 0x2774 0x2774 0x2774 0x2710 0x2710 0x2710>;
					PS_Config_Lmt_Short_Rawdata_P = <0x36b8 0x36b8 0x36b8 0x36b8 0x36b8 0x36b8 0x36b8 0x36b8 0x36b8 0x36b8 0x36b8 0x36b8 0x36b8 0x36b8 0x36b8 0x36b8 0x36b8 0x36b8 0x36b8 0x36b8 0x36b8 0x36b8 0x36b8 0x36b8 0x36b8 0x36b8 0x36b8 0x36b8 0x36b8 0x36b8 0x36b8 0x36b8 0x36b8 0x36b8 0x36b8 0x36b8 0x36b8 0x36b8 0x36b8 0x36b8 0x36b8 0x36b8 0x36b8 0x36b8 0x36b8 0x36b8 0x36b8 0x36b8 0x36b8 0x36b8 0x36b8 0x36b8 0x36b8 0x36b8 0x36b8 0x36b8 0x36b8 0x36b8 0x36b8 0x36b8 0x36b8 0x36b8 0x36b8 0x36b8 0x36b8 0x36b8 0x36b8 0x36b8 0x36b8 0x36b8 0x36b8 0x36b8 0x36b8 0x36b8 0x36b8 0x36b8 0x36b8 0x36b8 0x36b8 0x36b8 0x36b8 0x36b8 0x36b8 0x36b8 0x36b8 0x36b8 0x36b8 0x36b8 0x36b8 0x36b8 0x36b8 0x36b8 0x36b8 0x36b8 0x36b8 0x36b8 0x36b8 0x36b8 0x36b8 0x36b8 0x36b8 0x36b8 0x36b8 0x36b8 0x36b8 0x36b8 0x36b8 0x36b8 0x36b8 0x36b8 0x36b8 0x36b8 0x36b8 0x36b8 0x36b8 0x36b8 0x36b8 0x36b8 0x36b8 0x36b8 0x36b8 0x36b8 0x36b8 0x36b8 0x36b8 0x36b8 0x36b8 0x36b8 0x36b8 0x36b8 0x36b8 0x36b8 0x36b8 0x36b8 0x36b8 0x36b8 0x36b8 0x36b8 0x36b8 0x36b8 0x36b8 0x36b8 0x36b8 0x36b8 0x36b8 0x36b8 0x36b8 0x36b8 0x36b8 0x36b8 0x36b8 0x36b8 0x36b8 0x36b8 0x36b8 0x36b8 0x36b8 0x36b8 0x36b8 0x36b8 0x36b8 0x36b8 0x36b8 0x36b8 0x36b8 0x36b8 0x36b8 0x36b8 0x36b8 0x36b8 0x36b8 0x36b8 0x36b8 0x36b8 0x36b8 0x36b8 0x36b8 0x36b8 0x36b8 0x36b8 0x36b8 0x36b8 0x36b8 0x36b8 0x36b8 0x36b8 0x36b8 0x36b8 0x36b8 0x36b8 0x36b8 0x36b8 0x36b8 0x36b8 0x36b8 0x36b8 0x36b8 0x36b8 0x36b8 0x36b8 0x36b8 0x36b8 0x36b8 0x36b8 0x36b8 0x36b8 0x36b8 0x36b8 0x36b8 0x36b8 0x36b8 0x36b8 0x36b8 0x36b8 0x36b8 0x36b8 0x36b8 0x36b8 0x36b8 0x36b8 0x36b8 0x36b8 0x36b8 0x36b8 0x36b8 0x36b8 0x36b8 0x36b8 0x36b8 0x36b8 0x36b8 0x36b8 0x36b8 0x36b8 0x36b8 0x36b8 0x36b8 0x36b8 0x36b8 0x36b8 0x36b8 0x36b8 0x36b8 0x36b8 0x36b8 0x36b8 0x36b8 0x36b8 0x36b8 0x36b8 0x36b8 0x36b8 0x36b8 0x36b8 0x36b8 0x36b8 0x36b8 0x36b8 0x36b8 0x36b8 0x36b8 0x36b8 0x36b8 0x36b8 0x36b8 0x36b8 0x36b8 0x36b8 0x36b8 0x36b8 0x36b8 0x36b8 0x36b8 0x36b8 0x36b8 0x36b8 0x36b8 0x36b8 0x36b8 0x36b8 0x36b8 0x36b8 0x36b8 0x36b8 0x36b8 0x36b8 0x36b8 0x36b8 0x36b8 0x36b8 0x36b8 0x36b8 0x36b8 0x36b8 0x36b8 0x36b8 0x36b8 0x36b8 0x36b8 0x36b8 0x36b8 0x36b8 0x36b8 0x36b8 0x36b8 0x36b8 0x36b8 0x36b8 0x36b8 0x36b8 0x36b8 0x36b8 0x36b8 0x36b8 0x36b8 0x36b8 0x36b8 0x36b8 0x36b8 0x36b8 0x36b8 0x36b8 0x36b8 0x36b8 0x36b8 0x36b8 0x36b8 0x36b8 0x36b8 0x36b8 0x36b8 0x36b8 0x36b8 0x36b8 0x36b8 0x36b8 0x36b8 0x36b8 0x36b8 0x36b8 0x36b8 0x36b8 0x36b8 0x36b8 0x36b8 0x36b8 0x36b8 0x36b8 0x36b8 0x36b8 0x36b8 0x36b8 0x36b8 0x36b8 0x36b8 0x36b8 0x36b8 0x36b8 0x36b8 0x36b8 0x36b8 0x36b8 0x36b8 0x36b8 0x36b8 0x36b8 0x36b8 0x36b8 0x36b8 0x36b8 0x36b8 0x36b8 0x36b8 0x36b8 0x36b8 0x36b8 0x36b8 0x36b8 0x36b8 0x36b8 0x36b8 0x36b8 0x36b8 0x36b8 0x36b8 0x36b8 0x36b8 0x36b8 0x36b8 0x36b8 0x36b8 0x36b8 0x36b8 0x36b8 0x36b8 0x36b8 0x36b8 0x36b8 0x36b8 0x36b8 0x36b8 0x36b8 0x36b8 0x36b8 0x36b8 0x36b8 0x36b8 0x36b8 0x36b8 0x36b8 0x36b8 0x36b8 0x36b8 0x36b8 0x36b8 0x36b8 0x36b8 0x36b8 0x36b8 0x36b8 0x36b8 0x36b8 0x36b8 0x36b8 0x36b8 0x36b8 0x36b8 0x36b8 0x36b8 0x36b8 0x36b8 0x36b8 0x36b8 0x36b8 0x36b8 0x36b8 0x36b8 0x36b8 0x36b8 0x36b8 0x36b8 0x36b8 0x36b8 0x36b8 0x36b8 0x36b8 0x36b8 0x36b8 0x36b8 0x36b8 0x36b8 0x36b8 0x36b8 0x36b8 0x36b8 0x36b8 0x36b8 0x36b8 0x36b8 0x36b8 0x36b8 0x36b8 0x36b8 0x36b8 0x36b8 0x36b8 0x36b8 0x36b8 0x36b8 0x36b8 0x36b8 0x36b8 0x36b8 0x36b8 0x36b8 0x36b8 0x36b8 0x36b8 0x36b8 0x36b8 0x36b8 0x36b8 0x36b8 0x36b8 0x36b8 0x36b8 0x36b8 0x36b8 0x36b8 0x36b8 0x36b8 0x36b8 0x36b8 0x36b8 0x36b8 0x36b8 0x36b8 0x36b8 0x36b8 0x36b8 0x36b8 0x36b8 0x36b8 0x36b8 0x36b8 0x36b8 0x36b8 0x36b8 0x36b8 0x36b8 0x36b8 0x36b8 0x36b8 0x36b8 0x36b8 0x36b8 0x36b8 0x36b8 0x36b8 0x36b8 0x36b8 0x36b8 0x36b8 0x36b8 0x36b8 0x36b8 0x36b8 0x36b8 0x36b8 0x36b8 0x36b8 0x36b8 0x36b8 0x36b8 0x36b8 0x36b8 0x36b8 0x36b8 0x36b8 0x36b8 0x36b8 0x36b8 0x36b8 0x36b8 0x36b8 0x36b8 0x36b8 0x36b8 0x36b8 0x36b8 0x36b8 0x36b8 0x36b8 0x36b8 0x36b8 0x36b8 0x36b8 0x36b8 0x36b8 0x36b8 0x36b8 0x36b8 0x36b8 0x36b8 0x36b8 0x36b8 0x36b8 0x36b8 0x36b8 0x36b8 0x36b8 0x36b8 0x36b8 0x36b8 0x36b8 0x36b8 0x36b8 0x36b8 0x36b8>;
					X_Channel = <0x12>;
					Y_Channel = <0x20>;
					compatible = "novatek-mp-criteria-597D";
				};
			};
		};
	};

	fragment@1 {
		target = <0xffffffff>;

		__overlay__ {
			clock-frequency = <0x61a80>;
			status = "okay";

			nxp@28 {
				compatible = "qcom,nq-nci";
				interrupt-names = "nfc_irq";
				interrupt-parent = <0xffffffff>;
				interrupts = <0x6 0x4 0x6 0x0>;
				pinctrl-0 = <0x1>;
				pinctrl-1 = <0x2 0x3 0x4 0x5>;
				pinctrl-2 = <0x6 0x7 0x8 0x9>;
				pinctrl-names = "default", "nfc_active", "nfc_suspend";
				qcom,nq-clkreq = <0xffffffff 0xb 0x0>;
				qcom,nq-firm = <0xffffffff 0x11 0x0>;
				qcom,nq-irq = <0xffffffff 0x6 0x0>;
				qcom,nq-ven = <0xffffffff 0x9f 0x0>;
				reg = <0x28>;
				tms,download-gpio = <0xffffffff 0x11 0x0>;
				tms,irq-gpio = <0xffffffff 0x6 0x0>;
				tms,ven-gpio = <0xffffffff 0x9f 0x0>;
			};
		};
	};

	fragment@10 {
		target = <0xffffffff>;

		__overlay__ {
			pinctrl-0 = <0xa>;
			pinctrl-names = "default";
		};
	};

	fragment@11 {
		target = <0xffffffff>;

		__overlay__ {

			kpdgpiodefault {
				phandle = <0xa>;

				pins_cmd_dat {
					bias-pull-up = <0x66>;
					input-enable;
					input-schmitt-enable;
					pinmux = <0x5d01>;
				};
			};
		};
	};

	fragment@12 {
		target = <0xffffffff>;

		__overlay__ {
			interrupt-parent = <0xffffffff>;
			interrupts = <0x14 0x8 0x14 0x0>;
		};
	};

	fragment@13 {
		target = <0xffffffff>;

		__overlay__ {
			mt6370pd-intr-gpios = <0xffffffff 0x29 0x0>;
		};
	};

	fragment@14 {
		target = <0xffffffff>;

		__overlay__ {
			board-sensor = "VIRTUAL-SENSOR";
		};
	};

	fragment@15 {
		target = <0xffffffff>;

		__overlay__ {

			consys_default {
				phandle = <0xb>;
			};

			gpslna@0 {
				phandle = <0xc>;

				pins_cmd_dat {
					bias-disable;
					output-low;
					pinmux = <0x5e00>;
					slew-rate = <0x0>;
				};
			};

			gpslna@1 {
				phandle = <0xd>;

				pins_cmd_dat {
					output-high;
					pinmux = <0x5e00>;
					slew-rate = <0x1>;
				};
			};

			gpslna@2 {
				phandle = <0xe>;

				pins_cmd_dat {
					output-low;
					pinmux = <0x5e00>;
					slew-rate = <0x1>;
				};
			};
		};
	};

	fragment@16 {
		target = <0xffffffff>;

		__overlay__ {
			pinctrl-0 = <0xb>;
			pinctrl-1 = <0xc>;
			pinctrl-2 = <0xd>;
			pinctrl-3 = <0xe>;
			pinctrl-names = "default", "gps_lna_state_init", "gps_lna_state_oh", "gps_lna_state_ol";
			status = "okay";
		};
	};

	fragment@17 {
		target = <0xffffffff>;

		__overlay__ {
			pinctrl-0 = <0xf>;
			pinctrl-1 = <0x10>;
			pinctrl-names = "irtx_gpio_led_default", "irtx_gpio_led_set";
			status = "okay";
		};
	};

	fragment@18 {
		target = <0xffffffff>;

		__overlay__ {

			irtx_gpio_led_def@gpio12 {
				phandle = <0xf>;

				pins_cmd_dat {
					bias-disable;
					input-schmitt-enable = <0x0>;
					output-low;
					pinmux = <0xc00>;
					slew-rate = <0x1>;
				};
			};

			irtx_gpio_led_set@gpio12 {
				phandle = <0x10>;

				pins_cmd_dat {
					output-high;
					pinmux = <0xc01>;
					slew-rate = <0x1>;
				};
			};
		};
	};

	fragment@19 {
		target = <0xffffffff>;

		__overlay__ {

			lcm_dsi_te {
				phandle = <0x13>;

				pins_cmd_dat {
					pinmux = <0x2c01>;
				};
			};

			lcm_err_flag {
				phandle = <0x14>;

				pins_cmd_dat {
					bias-disable;
					pinmux = <0x900>;
					slew-rate = <0x0>;
				};
			};

			lcm_rst_out0_gpio {
				phandle = <0x12>;

				pins_cmd_dat {
					output-low;
					pinmux = <0x2d00>;
					slew-rate = <0x1>;
				};
			};

			lcm_rst_out1_gpio {
				phandle = <0x11>;

				pins_cmd_dat {
					output-high;
					pinmux = <0x2d00>;
					slew-rate = <0x1>;
				};
			};
		};
	};

	fragment@2 {
		target = <0xffffffff>;

		__overlay__ {

			nfc_clk_req_active {
				phandle = <0x5>;

				pins_cmd_dat {
					bias-pull-up;
					drive-strength = <0x2>;
					input-enable;
					pinmux = <0xb01>;
					slew-rate = <0x0>;
				};
			};

			nfc_clk_req_suspend {
				phandle = <0x9>;

				pins_cmd_dat {
					bias-pull-down;
					drive-strength = <0x2>;
					input-enable;
					pinmux = <0xb01>;
					slew-rate = <0x0>;
				};
			};

			nfc_default {
				phandle = <0x1>;
			};

			nfc_enable_active {
				phandle = <0x3>;

				pins_cmd_dat {
					bias-pull-up = <0x67>;
					drive-strength = <0x2>;
					output-high;
					pinmux = <0x1300>;
					slew-rate = <0x1>;
				};
			};

			nfc_enable_suspend {
				phandle = <0x7>;

				pins_cmd_dat {
					bias-disable;
					drive-strength = <0x2>;
					pinmux = <0x1300>;
					slew-rate = <0x1>;
				};
			};

			nfc_firmwaredownload_active {
				phandle = <0x4>;

				pins_cmd_dat {
					bias-pull-up;
					drive-strength = <0x2>;
					pinmux = <0x1100>;
					slew-rate = <0x1>;
				};
			};

			nfc_firmwaredownload_suspend {
				phandle = <0x8>;

				pins_cmd_dat {
					bias-disable;
					drive-strength = <0x2>;
					pinmux = <0x1100>;
					slew-rate = <0x1>;
				};
			};

			nfc_int_active {
				phandle = <0x2>;

				pins_cmd_dat {
					bias-pull-up;
					drive-strength = <0x2>;
					pinmux = <0x600>;
					slew-rate = <0x0>;
				};
			};

			nfc_int_suspend {
				phandle = <0x6>;

				pins_cmd_dat {
					bias-pull-up;
					drive-strength = <0x2>;
					pinmux = <0x600>;
					slew-rate = <0x0>;
				};
			};
		};
	};

	fragment@20 {
		target = <0xffffffff>;

		__overlay__ {
			pinctrl-0 = <0x11>;
			pinctrl-1 = <0x12>;
			pinctrl-2 = <0x13>;
			pinctrl-3 = <0x14>;
			pinctrl-names = "lcm_rst_out1_gpio", "lcm_rst_out0_gpio", "mode_te_te", "err_flag_init";
			status = "okay";
		};
	};

	fragment@21 {
		target = <0xffffffff>;

		__overlay__ {
			pinctrl-0 = <0x11>;
			pinctrl-1 = <0x12>;
			pinctrl-2 = <0x13>;
			pinctrl-3 = <0x14>;
			pinctrl-names = "lcm_rst_out1_gpio", "lcm_rst_out0_gpio", "mode_te_te", "err_flag_init";
			status = "okay";
		};
	};

	fragment@22 {
		target = <0xffffffff>;

		__overlay__ {
			#address-cells = <0x1>;
			#size-cells = <0x0>;
			status = "okay";

			panel1@0 {
				compatible = "dsi_panel_c3u,lcm";
				enn-gpios = <0xffffffff 0xa5 0x0>;
				enp-gpios = <0xffffffff 0xa9 0x0>;
				mi,esd-err-irq-gpio = <0xffffffff 0x9 0x2002>;
				reg = <0x0>;
				reset-gpios = <0xffffffff 0x2d 0x0>;
				status = "okay";

				port {

					endpoint {
						phandle = <0x16>;
						remote-endpoint = <0x15>;
					};
				};
			};

			ports {

				port {

					endpoint {
						phandle = <0x15>;
						remote-endpoint = <0x16>;
					};
				};
			};
		};
	};

	fragment@23 {
		target = <0xffffffff>;

		__overlay__ {

			bias_lcd@3e {
				compatible = "bias,lcd_bias";
				phandle = <0x54>;
				reg = <0x3e>;
				status = "okay";
			};
		};
	};

	fragment@24 {
		target = <0xffffffff>;

		__overlay__ {

			mt6660@34 {
				#sound-dai-cells = <0x0>;
				compatible = "mediatek,mt6660";
				phandle = <0x17>;
				reg = <0x34>;
				status = "disabled";
			};
		};
	};

	fragment@25 {
		target = <0xffffffff>;

		__overlay__ {

			mediatek,speaker-codec {
				sound-dai = <0x17>;
			};
		};
	};

	fragment@26 {
		target = <0xffffffff>;

		__overlay__ {
			status = "ok";
		};
	};

	fragment@27 {
		target = <0xffffffff>;

		__overlay__ {
			status = "ok";
		};
	};

	fragment@28 {
		target = <0xffffffff>;

		__overlay__ {

			MTEE {
				compatible = "mediatek,mtk_svp_on_mtee_support";
				phandle = <0x55>;
			};

			SecureVideoPath {
				compatible = "mediatek,mtk_sec_video_path_support";
				phandle = <0x56>;
			};
		};
	};

	fragment@29 {
		target = <0xffffffff>;

		__overlay__ {

			adc_channel@ {
				compatible = "mediatek,adc_channel";
				mediatek,adc_fdd_rf_params_dynamic_custom_ch = <0x2>;
				mediatek,temperature0 = <0x0>;
				mediatek,temperature1 = <0x1>;
				status = "okay";
			};
		};
	};

	fragment@3 {
		target = <0xffffffff>;

		__overlay__ {

			reserve-memory-scp_share {
				alignment = <0x0 0x1000000>;
				alloc-ranges = <0x0 0x40000000 0x0 0x50000000>;
				compatible = "mediatek,reserve-memory-scp_share";
				no-map;
				size = <0x0 0xd00000>;
			};
		};
	};

	fragment@30 {
		target = <0xffffffff>;

		__overlay__ {
			io-channels = <0xffffffff 0x2>;
		};
	};

	fragment@31 {
		target = <0xffffffff>;

		__overlay__ {
			mediatek,clkbuf-config = <0x2 0x1 0x1 0x2 0x0 0x0 0x0>;
			mediatek,clkbuf-driving-current = <0x1 0x1 0x1 0x1 0x1 0x1 0x1>;
			mediatek,clkbuf-quantity = <0x7>;
			status = "okay";
		};
	};

	fragment@32 {
		target = <0xffffffff>;

		__overlay__ {
			#address-cells = <0x1>;
			#size-cells = <0x0>;
			clock-frequency = <0x61a80>;
			mediatek,use-open-drain;
		};
	};

	fragment@33 {
		target = <0xffffffff>;

		__overlay__ {
			#address-cells = <0x1>;
			#size-cells = <0x0>;
			clock-frequency = <0x61a80>;
			mediatek,use-open-drain;
		};
	};

	fragment@34 {
		target = <0xffffffff>;

		__overlay__ {
			#address-cells = <0x1>;
			#size-cells = <0x0>;
			clock-frequency = <0x61a80>;
			mediatek,use-open-drain;

			camera_main@1a {
				compatible = "mediatek,camera_main";
				phandle = <0x57>;
				reg = <0x1a>;
				status = "okay";
			};

			camera_main_af@18 {
				camaf_m1_pmic-supply = <0xffffffff>;
				camio_m1_pmic-supply = <0xffffffff>;
				compatible = "mediatek,camera_main_af";
				phandle = <0x59>;
				reg = <0x18>;
				status = "okay";
			};

			camera_main_eeprom@50 {
				compatible = "mediatek,camera_main_eeprom";
				phandle = <0x58>;
				reg = <0x50>;
				status = "okay";
			};

			camera_main_two@10 {
				compatible = "mediatek,camera_main_two";
				phandle = <0x5a>;
				reg = <0x10>;
				status = "okay";
			};

			camera_main_two_eeprom@52 {
				compatible = "mediatek,camera_main_two_eeprom";
				phandle = <0x5b>;
				reg = <0x52>;
				status = "okay";
			};

			ccu_sensor_i2c_2_hw@11 {
				compatible = "mediatek,ccu_sensor_i2c_2_hw";
				phandle = <0x5c>;
				reg = <0x11>;
				status = "okay";
			};
		};
	};

	fragment@35 {
		target = <0xffffffff>;

		__overlay__ {
			#address-cells = <0x1>;
			#size-cells = <0x0>;
			clock-frequency = <0x61a80>;
			mediatek,use-open-drain;
		};
	};

	fragment@36 {
		target = <0xffffffff>;

		__overlay__ {
			#address-cells = <0x1>;
			#size-cells = <0x0>;
			clock-frequency = <0x61a80>;
			mediatek,use-open-drain;

			camera_sub@2d {
				compatible = "mediatek,camera_sub";
				phandle = <0x5d>;
				reg = <0x2d>;
				status = "okay";
			};

			camera_sub_eeprom@51 {
				compatible = "mediatek,camera_sub_eeprom";
				phandle = <0x5e>;
				reg = <0x51>;
				status = "okay";
			};

			ccu_sensor_i2c_4_hw@12 {
				compatible = "mediatek,ccu_sensor_i2c_4_hw";
				phandle = <0x5f>;
				reg = <0x12>;
				status = "okay";
			};
		};
	};

	fragment@37 {
		target = <0xffffffff>;

		__overlay__ {
			#address-cells = <0x1>;
			#size-cells = <0x0>;
			clock-frequency = <0x33e140>;
			mediatek,use-push-pull;
		};
	};

	fragment@38 {
		target = <0xffffffff>;

		__overlay__ {
			#address-cells = <0x1>;
			#size-cells = <0x0>;
			clock-frequency = <0x61a80>;
			mediatek,use-open-drain;
		};
	};

	fragment@39 {
		target = <0xffffffff>;

		__overlay__ {
			#address-cells = <0x1>;
			#size-cells = <0x0>;
			clock-frequency = <0x61a80>;
			mediatek,use-open-drain;

			slave_charger@4b {
				compatible = "mediatek,slave_charger";
				phandle = <0x60>;
				reg = <0x4b>;
				status = "okay";
			};
		};
	};

	fragment@4 {
		target = <0xffffffff>;

		__overlay__ {
			atag,videolfb-fb_base_h = <0x0>;
			atag,videolfb-fb_base_l = "~`P";
			atag,videolfb-fps = <0x1770>;
			atag,videolfb-islcm_inited = <0x0>;
			atag,videolfb-islcmfound = <0x1>;
			atag,videolfb-lcmname = "hx83112b_fhdp_dsi_cmd_auo_rt5081_drv";
			atag,videolfb-vramSize = <0x17e8000>;
		};
	};

	fragment@40 {
		target = <0xffffffff>;

		__overlay__ {
			#address-cells = <0x1>;
			#size-cells = <0x0>;
			clock-frequency = <0x61a80>;
			mediatek,use-open-drain;
		};
	};

	fragment@41 {
		target = <0xffffffff>;

		__overlay__ {
			GPIO_FDD_BAND_SUPPORT_DETECT_1ST_PIN = <0xffffffff 0xc 0x0>;
			GPIO_FDD_BAND_SUPPORT_DETECT_2ND_PIN = <0xffffffff 0x9e 0x0>;
			GPIO_FDD_BAND_SUPPORT_DETECT_3RD_PIN = <0xffffffff 0x15 0x0>;
			GPIO_FDD_BAND_SUPPORT_DETECT_4TH_PIN = <0xffffffff 0x17 0x0>;
			GPIO_FDD_BAND_SUPPORT_DETECT_5TH_PIN = <0xffffffff 0x18 0x0>;
			GPIO_FDD_BAND_SUPPORT_DETECT_6TH_PIN = <0xffffffff 0x16 0x0>;
			GPIO_SIM1_HOT_PLUG = <0xffffffff 0x2f 0x0>;
			GPIO_SIM1_SCLK = <0xffffffff 0xac 0x0>;
			GPIO_SIM1_SIO = <0xffffffff 0xae 0x0>;
			GPIO_SIM1_SRST = <0xffffffff 0xad 0x0>;
			GPIO_SIM2_HOT_PLUG = <0xffffffff 0x2e 0x0>;
			GPIO_SIM2_SCLK = <0xffffffff 0x9d 0x0>;
			GPIO_SIM2_SIO = <0xffffffff 0x9b 0x0>;
			GPIO_SIM2_SRST = <0xffffffff 0x9c 0x0>;
		};
	};

	fragment@42 {
		target = <0xffffffff>;

		__overlay__ {
			gpio_init_default = <0x0 0x0 0x0 0x0 0x1 0x1 0x1 0x1 0x0 0x0 0x0 0x1 0x1 0x1 0x2 0x0 0x0 0x0 0x1 0x0 0x1 0x3 0x0 0x0 0x0 0x1 0x0 0x1 0x4 0x0 0x0 0x0 0x1 0x0 0x0 0x5 0x0 0x0 0x0 0x1 0x1 0x1 0x6 0x0 0x0 0x0 0x1 0x1 0x0 0x7 0x0 0x0 0x0 0x1 0x0 0x0 0x8 0x0 0x0 0x0 0x1 0x0 0x1 0x9 0x0 0x0 0x0 0x1 0x0 0x0 0xa 0x0 0x0 0x0 0x1 0x1 0x0 0xb 0x1 0x0 0x0 0x1 0x0 0x0 0xc 0x0 0x0 0x0 0x0 0x0 0x0 0xd 0x2 0x0 0x0 0x1 0x0 0x0 0xe 0x0 0x0 0x0 0x0 0x0 0x0 0xf 0x2 0x1 0x0 0x0 0x0 0x0 0x10 0x2 0x1 0x0 0x0 0x0 0x0 0x11 0x0 0x1 0x0 0x1 0x0 0x1 0x12 0x0 0x0 0x0 0x1 0x1 0x1 0x13 0x0 0x0 0x0 0x1 0x1 0x1 0x14 0x0 0x0 0x0 0x1 0x1 0x1 0x15 0x0 0x0 0x0 0x0 0x0 0x0 0x16 0x0 0x0 0x0 0x0 0x0 0x0 0x17 0x0 0x0 0x0 0x0 0x0 0x0 0x18 0x0 0x0 0x0 0x0 0x0 0x0 0x19 0x2 0x0 0x0 0x1 0x1 0x0 0x1a 0x2 0x0 0x0 0x1 0x0 0x0 0x1b 0x2 0x1 0x0 0x0 0x0 0x0 0x1c 0x2 0x0 0x0 0x1 0x0 0x0 0x1d 0x0 0x1 0x0 0x0 0x0 0x0 0x1e 0x0 0x1 0x0 0x0 0x0 0x0 0x1f 0x0 0x1 0x0 0x1 0x0 0x0 0x20 0x1 0x0 0x0 0x1 0x0 0x0 0x21 0x1 0x1 0x0 0x0 0x0 0x0 0x22 0x1 0x1 0x0 0x0 0x0 0x0 0x23 0x1 0x1 0x0 0x0 0x0 0x0 0x24 0x2 0x1 0x0 0x0 0x0 0x0 0x25 0x2 0x1 0x0 0x0 0x0 0x0 0x26 0x2 0x1 0x0 0x0 0x0 0x0 0x27 0x0 0x0 0x0 0x1 0x1 0x1 0x28 0x2 0x0 0x0 0x1 0x0 0x0 0x29 0x0 0x0 0x0 0x1 0x1 0x1 0x2a 0x0 0x0 0x0 0x1 0x1 0x1 0x2b 0x1 0x1 0x0 0x0 0x0 0x0 0x2c 0x1 0x0 0x0 0x1 0x0 0x0 0x2d 0x0 0x1 0x0 0x0 0x0 0x0 0x2e 0x1 0x0 0x0 0x1 0x1 0x0 0x2f 0x1 0x0 0x0 0x1 0x1 0x0 0x30 0x1 0x0 0x0 0x1 0x1 0x1 0x31 0x1 0x0 0x0 0x1 0x1 0x1 0x32 0x1 0x0 0x0 0x1 0x1 0x1 0x33 0x1 0x0 0x0 0x1 0x1 0x1 0x34 0x1 0x0 0x0 0x1 0x0 0x0 0x35 0x1 0x0 0x0 0x1 0x0 0x0 0x36 0x1 0x0 0x0 0x1 0x0 0x0 0x37 0x1 0x0 0x0 0x1 0x0 0x0 0x38 0x1 0x0 0x0 0x1 0x0 0x0 0x39 0x1 0x0 0x0 0x1 0x0 0x0 0x3a 0x0 0x0 0x0 0x1 0x0 0x0 0x3b 0x1 0x0 0x0 0x1 0x0 0x0 0x3c 0x1 0x0 0x0 0x1 0x0 0x0 0x3d 0x1 0x0 0x0 0x1 0x0 0x0 0x3e 0x1 0x0 0x0 0x1 0x0 0x0 0x3f 0x1 0x0 0x0 0x1 0x0 0x0 0x40 0x1 0x0 0x0 0x1 0x0 0x0 0x41 0x1 0x0 0x0 0x1 0x0 0x0 0x42 0x1 0x0 0x0 0x1 0x0 0x0 0x43 0x1 0x0 0x0 0x1 0x0 0x0 0x44 0x1 0x0 0x0 0x1 0x0 0x0 0x45 0x1 0x0 0x0 0x1 0x0 0x0 0x46 0x1 0x0 0x0 0x1 0x0 0x0 0x47 0x1 0x0 0x0 0x1 0x0 0x0 0x48 0x1 0x0 0x0 0x1 0x0 0x0 0x49 0x1 0x0 0x0 0x1 0x0 0x0 0x4a 0x1 0x0 0x0 0x1 0x0 0x0 0x4b 0x1 0x0 0x0 0x1 0x0 0x0 0x4c 0x1 0x0 0x0 0x1 0x0 0x0 0x4d 0x1 0x0 0x0 0x1 0x0 0x0 0x4e 0x0 0x0 0x0 0x0 0x0 0x0 0x4f 0x0 0x0 0x0 0x1 0x0 0x0 0x50 0x0 0x0 0x0 0x1 0x0 0x0 0x51 0x3 0x0 0x0 0x1 0x1 0x1 0x52 0x1 0x0 0x0 0x1 0x1 0x1 0x53 0x1 0x0 0x0 0x1 0x1 0x1 0x54 0x3 0x0 0x0 0x1 0x1 0x1 0x55 0x2 0x0 0x0 0x1 0x0 0x0 0x56 0x2 0x1 0x0 0x0 0x0 0x0 0x57 0x2 0x1 0x0 0x0 0x0 0x0 0x58 0x2 0x1 0x0 0x0 0x0 0x0 0x59 0x1 0x0 0x0 0x1 0x1 0x1 0x5a 0x1 0x0 0x0 0x1 0x1 0x1 0x5b 0x0 0x0 0x0 0x0 0x0 0x0 0x5c 0x0 0x1 0x1 0x1 0x1 0x0 0x5d 0x1 0x0 0x0 0x1 0x1 0x0 0x5e 0x0 0x1 0x0 0x0 0x0 0x0 0x5f 0x1 0x0 0x0 0x1 0x1 0x0 0x60 0x1 0x1 0x0 0x0 0x0 0x0 0x61 0x0 0x1 0x0 0x0 0x0 0x0 0x62 0x0 0x1 0x0 0x0 0x0 0x0 0x63 0x1 0x1 0x0 0x0 0x0 0x0 0x64 0x1 0x1 0x0 0x0 0x0 0x0 0x65 0x0 0x1 0x0 0x0 0x0 0x0 0x66 0x0 0x1 0x0 0x0 0x0 0x0 0x67 0x1 0x0 0x0 0x1 0x1 0x1 0x68 0x1 0x0 0x0 0x1 0x1 0x1 0x69 0x1 0x0 0x0 0x1 0x1 0x1 0x6a 0x1 0x0 0x0 0x1 0x1 0x1 0x6b 0x0 0x1 0x0 0x0 0x0 0x0 0x6c 0x1 0x1 0x0 0x0 0x0 0x0 0x6d 0x0 0x1 0x0 0x0 0x0 0x0 0x6e 0x0 0x1 0x0 0x0 0x0 0x0 0x6f 0x1 0x1 0x0 0x0 0x0 0x0 0x70 0x0 0x0 0x0 0x0 0x0 0x0 0x71 0x0 0x0 0x0 0x1 0x0 0x0 0x72 0x0 0x0 0x0 0x1 0x0 0x0 0x73 0x0 0x0 0x0 0x1 0x0 0x0 0x74 0x0 0x0 0x0 0x1 0x0 0x0 0x75 0x0 0x0 0x0 0x1 0x0 0x0 0x76 0x0 0x0 0x0 0x1 0x0 0x0 0x77 0x0 0x0 0x0 0x1 0x0 0x0 0x78 0x0 0x0 0x0 0x1 0x0 0x0 0x79 0x0 0x0 0x0 0x1 0x0 0x0 0x86 0x1 0x0 0x0 0x1 0x0 0x1 0x87 0x1 0x1 0x0 0x0 0x0 0x0 0x88 0x1 0x1 0x0 0x0 0x0 0x0 0x89 0x1 0x1 0x0 0x0 0x0 0x0 0x8a 0x1 0x1 0x0 0x0 0x0 0x0 0x8b 0x1 0x1 0x0 0x0 0x0 0x0 0x8c 0x1 0x0 0x0 0x1 0x0 0x0 0x8d 0x1 0x0 0x0 0x1 0x0 0x0 0x8e 0x1 0x0 0x0 0x1 0x0 0x0 0x8f 0x1 0x0 0x0 0x1 0x0 0x0 0x90 0x1 0x0 0x0 0x1 0x0 0x0 0x91 0x1 0x1 0x0 0x0 0x0 0x0 0x92 0x1 0x1 0x0 0x0 0x0 0x0 0x93 0x1 0x1 0x0 0x0 0x0 0x0 0x94 0x1 0x1 0x0 0x0 0x0 0x0 0x95 0x1 0x1 0x0 0x0 0x0 0x0 0x96 0x0 0x1 0x0 0x0 0x0 0x0 0x97 0x0 0x1 0x0 0x0 0x0 0x1 0x98 0x5 0x0 0x0 0x1 0x1 0x0 0x99 0x0 0x1 0x0 0x0 0x0 0x0 0x9a 0x1 0x1 0x0 0x0 0x0 0x0 0x9b 0x1 0x0 0x0 0x1 0x1 0x0 0x9c 0x1 0x1 0x0 0x0 0x0 0x0 0x9d 0x1 0x1 0x0 0x0 0x0 0x0 0x9e 0x0 0x0 0x0 0x0 0x0 0x0 0x9f 0x0 0x1 0x1 0x1 0x1 0x0 0xa0 0x0 0x1 0x0 0x0 0x0 0x0 0xa1 0x1 0x0 0x0 0x1 0x1 0x1 0xa2 0x1 0x0 0x0 0x1 0x1 0x1 0xa3 0x1 0x0 0x0 0x1 0x1 0x1 0xa4 0x1 0x0 0x0 0x1 0x1 0x1 0xa5 0x0 0x1 0x0 0x1 0x0 0x1 0xa6 0x0 0x1 0x0 0x0 0x0 0x0 0xa7 0x1 0x0 0x0 0x1 0x0 0x0 0xa8 0x1 0x0 0x0 0x1 0x0 0x0 0xa9 0x0 0x1 0x0 0x1 0x0 0x1 0xaa 0x1 0x0 0x0 0x1 0x1 0x1 0xab 0x1 0x1 0x0 0x0 0x0 0x1 0xac 0x1 0x1 0x0 0x0 0x0 0x0 0xad 0x1 0x1 0x0 0x0 0x0 0x0 0xae 0x1 0x0 0x0 0x1 0x1 0x0 0xaf 0x2 0x0 0x0 0x1 0x1 0x1 0xb0 0x2 0x0 0x0 0x1 0x1 0x1 0xb2 0x0 0x1 0x0 0x0 0x0 0x0 0xb3 0x0 0x1 0x0 0x0 0x0 0x0 0xb4 0x0 0x0 0x0 0x1 0x0 0x0 0xb5 0x0 0x0 0x0 0x1 0x0 0x0 0xb6 0x0 0x0 0x0 0x1 0x0 0x0 0xb7 0x0 0x0 0x0 0x1 0x0 0x0 0xb8 0x0 0x0 0x0 0x1 0x0 0x0 0xb9 0x0 0x0 0x0 0x1 0x0 0x0 0xba 0x0 0x0 0x0 0x1 0x0 0x0>;
		};
	};

	fragment@43 {
		target = <0xffffffff>;

		__overlay__ {
			deb-gpios = <0xffffffff 0x0 0x0>;
			debounce = <0x7d000>;
			interrupt-parent = <0xffffffff>;
			interrupts = <0x0 0x8 0x0 0x0>;
			status = "okay";
		};
	};

	fragment@44 {
		target = <0xffffffff>;

		__overlay__ {
			interrupt-parent = <0xffffffff>;
			interrupts = <0x1 0x2 0x1 0x0>;
			status = "okay";
		};
	};

	fragment@45 {
		target = <0xffffffff>;

		__overlay__ {
			interrupt-parent = <0xffffffff>;
			interrupts = <0x6 0x8 0x6 0x0>;
			status = "okay";
		};
	};

	fragment@46 {
		target = <0xffffffff>;

		__overlay__ {
			interrupt-parent = <0xffffffff>;
			interrupts = <0x8 0x1 0x8 0x0>;
			status = "okay";
		};
	};

	fragment@47 {
		target = <0xffffffff>;

		__overlay__ {
			interrupt-parent = <0xffffffff>;
			interrupts = <0x9 0x1 0x9 0x0>;
			status = "okay";
		};
	};

	fragment@48 {
		target = <0xffffffff>;

		__overlay__ {
			interrupt-parent = <0xffffffff>;
			interrupts = <0x14 0x2 0x14 0x0>;
			status = "okay";
		};
	};

	fragment@49 {
		target = <0xffffffff>;

		__overlay__ {
			interrupt-parent = <0xffffffff>;
			interrupts = <0x27 0x8 0x27 0x0>;
			status = "okay";
		};
	};

	fragment@5 {
		target = <0xffffffff>;

		__overlay__ {
			compatible = "mediatek,disp-leds";

			backlight {
				gate_enable = <0x1>;
				led-bit = <0xc>;
				led_mode = <0x4>;
				max-brightness = <0xfff>;
				max-hw-brightness = <0xfff>;
				min-brightness = <0x1>;
				trans-bits = <0xc>;
			};
		};
	};

	fragment@50 {
		target = <0xffffffff>;

		__overlay__ {
			interrupt-parent = <0xffffffff>;
			interrupts = <0x29 0x2 0x29 0x0>;
			status = "okay";
		};
	};

	fragment@51 {
		target = <0xffffffff>;

		__overlay__ {
			interrupt-parent = <0xffffffff>;
			interrupts = <0x2a 0x2 0x2a 0x0>;
			status = "okay";
		};
	};

	fragment@52 {
		target = <0xffffffff>;

		__overlay__ {
			interrupt-parent = <0xffffffff>;
			interrupts = <0x2c 0x1 0x2c 0x1>;
			status = "okay";
		};
	};

	fragment@53 {
		target = <0xffffffff>;

		__overlay__ {
			deb-gpios = <0xffffffff 0x4e 0x0>;
			debounce = <0x7d000>;
			interrupt-parent = <0xffffffff>;
			interrupts = <0x4e 0x8 0x4e 0x0>;
			status = "okay";
		};
	};

	fragment@54 {
		target = <0xffffffff>;

		__overlay__ {
			interrupt-parent = <0xffffffff>;
			interrupts = <0x90 0x4 0xb4 0x0>;
			status = "okay";
		};
	};

	fragment@55 {
		target = <0xffffffff>;

		__overlay__ {
			compatible = "mediatek,md1_sim1_hot_plug_eint-eint";
			debounce = <0x0 0x2710>;
			dedicated = <0x0 0x0>;
			interrupts = <0x0 0x8>;
			sockettype = <0x0 0x0>;
			src_pin = <0x0 0x1>;
			status = "okay";
		};
	};

	fragment@56 {
		target = <0xffffffff>;

		__overlay__ {
			compatible = "mediatek,md1_sim2_hot_plug_eint-eint";
			debounce = <0x1 0x2710>;
			dedicated = <0x1 0x0>;
			interrupts = <0x1 0x8>;
			sockettype = <0x1 0x0>;
			src_pin = <0x1 0x2>;
			status = "okay";
		};
	};

	fragment@57 {
		target = <0xffffffff>;

		__overlay__ {
			regulator-default-on = <0x1>;
			regulator-name = "vcama1";
			status = "okay";
		};
	};

	fragment@58 {
		target = <0xffffffff>;

		__overlay__ {
			regulator-default-on = <0x1>;
			regulator-name = "vcama2";
			status = "okay";
		};
	};

	fragment@59 {
		target = <0xffffffff>;

		__overlay__ {
			regulator-default-on = <0x1>;
			regulator-name = "vcamd";
			status = "okay";
		};
	};

	fragment@6 {
		target = <0xffffffff>;

		__overlay__ {
			microtrust,real-drv = <0x1>;
		};
	};

	fragment@60 {
		target = <0xffffffff>;

		__overlay__ {
			regulator-default-on = <0x1>;
			regulator-name = "vcamio";
			status = "okay";
		};
	};

	fragment@61 {
		target = <0xffffffff>;

		__overlay__ {
			regulator-default-on = <0x1>;
			regulator-name = "vldo28";
			status = "okay";
		};
	};

	fragment@62 {
		target = <0xffffffff>;

		__overlay__ {
			status = "okay";
			vcama-supply = <0xffffffff>;
			vcama_sub-supply = <0xffffffff>;
			vcamaf-supply = <0xffffffff>;
			vcamaf_main2-supply = <0xffffffff>;
			vcamaf_sub-supply = <0xffffffff>;
			vcamd_main2-supply = <0xffffffff>;
			vcamio-supply = <0xffffffff>;
			vcamio_main2-supply = <0xffffffff>;
			vcamio_sub-supply = <0xffffffff>;
		};
	};

	fragment@63 {
		target = <0xffffffff>;

		__overlay__ {
			status = "okay";
			vtouch-supply = <0xffffffff>;
		};
	};

	fragment@64 {
		target = <0xffffffff>;

		__overlay__ {
			mediatek,kpd-hw-dl-key0 = <0x11>;
			mediatek,kpd-hw-dl-key1 = <0x0>;
			mediatek,kpd-hw-dl-key2 = <0x8>;
			mediatek,kpd-hw-factory-key = <0x0>;
			mediatek,kpd-hw-init-map = <0x72 0x0 0x0 0x0 0x0 0x0 0x0 0x0 0x0 0x0 0x0 0x0 0x0 0x0 0x0 0x0 0x0 0x0 0x0 0x0 0x0 0x0 0x0 0x0 0x0 0x0 0x0 0x0 0x0 0x0 0x0 0x0 0x0 0x0 0x0 0x0 0x0 0x0 0x0 0x0 0x0 0x0 0x0 0x0 0x0 0x0 0x0 0x0 0x0 0x0 0x0 0x0 0x0 0x0 0x0 0x0 0x0 0x0 0x0 0x0 0x0 0x0 0x0 0x0 0x0 0x0 0x0 0x0 0x0 0x0 0x0 0x0>;
			mediatek,kpd-hw-map-num = <0x48>;
			mediatek,kpd-hw-pwrkey = <0x8>;
			mediatek,kpd-hw-recovery-key = <0x11>;
			mediatek,kpd-hw-rstkey = <0x11>;
			mediatek,kpd-key-debounce = <0x400>;
			mediatek,kpd-pwkey-gpio-din = <0x0>;
			mediatek,kpd-pwrkey-eint-gpio = <0x0>;
			mediatek,kpd-sw-pwrkey = <0x74>;
			mediatek,kpd-sw-rstkey = <0x73>;
			mediatek,kpd-use-extend-type = <0x0>;
			status = "okay";
		};
	};

	fragment@65 {
		target = <0xffffffff>;

		__overlay__ {

			camdefault {
				phandle = <0x18>;
			};

			camera0_mclk_2mA@gpio100 {
				phandle = <0x2a>;

				pins_cmd_dat {
					drive-strength = <0x2>;
					pinmux = <0x6401>;
				};
			};

			camera0_mclk_4mA@gpio100 {
				phandle = <0x2b>;

				pins_cmd_dat {
					drive-strength = <0x4>;
					pinmux = <0x6401>;
				};
			};

			camera0_mclk_6mA@gpio100 {
				phandle = <0x2c>;

				pins_cmd_dat {
					drive-strength = <0x6>;
					pinmux = <0x6401>;
				};
			};

			camera0_mclk_8mA@gpio100 {
				phandle = <0x2d>;

				pins_cmd_dat {
					drive-strength = <0x7>;
					pinmux = <0x6401>;
				};
			};

			camera0_mclk_gpio_mode@gpio100 {
				phandle = <0x29>;

				pins_cmd_dat {
					drive-strength = <0x4>;
					pinmux = <0x6400>;
				};
			};

			camera0_pdn_output_high@gpio98 {
				phandle = <0x1c>;

				pins_cmd_dat {
					output-high;
					pinmux = <0x6200>;
				};
			};

			camera0_pdn_output_low@gpio98 {
				phandle = <0x1b>;

				pins_cmd_dat {
					output-low;
					pinmux = <0x6200>;
				};
			};

			camera0_rst_output_high@gpio102 {
				phandle = <0x1a>;

				pins_cmd_dat {
					output-high;
					pinmux = <0x6600>;
				};
			};

			camera0_rst_output_low@gpio102 {
				phandle = <0x19>;

				pins_cmd_dat {
					output-low;
					pinmux = <0x6600>;
				};
			};

			camera0_vcamd_output_high@gpio178 {
				phandle = <0x25>;

				pins_cmd_dat {
					output-high;
					pinmux = <0xb200>;
				};
			};

			camera0_vcamd_output_low@gpio178 {
				phandle = <0x26>;

				pins_cmd_dat {
					output-low;
					pinmux = <0xb200>;
				};
			};

			camera1_mclk_2mA@gpio99 {
				phandle = <0x2f>;

				pins_cmd_dat {
					drive-strength = <0x2>;
					pinmux = <0x6301>;
				};
			};

			camera1_mclk_4mA@gpio99 {
				phandle = <0x30>;

				pins_cmd_dat {
					drive-strength = <0x4>;
					pinmux = <0x6301>;
				};
			};

			camera1_mclk_6mA@gpio99 {
				phandle = <0x31>;

				pins_cmd_dat {
					drive-strength = <0x6>;
					pinmux = <0x6301>;
				};
			};

			camera1_mclk_8mA@gpio99 {
				phandle = <0x32>;

				pins_cmd_dat {
					drive-strength = <0x7>;
					pinmux = <0x6301>;
				};
			};

			camera1_mclk_gpio_mode@gpio99 {
				phandle = <0x2e>;

				pins_cmd_dat {
					drive-strength = <0x4>;
					pinmux = <0x6300>;
				};
			};

			camera1_pdn_output_high@gpio97 {
				phandle = <0x20>;

				pins_cmd_dat {
					output-high;
					pinmux = <0x6100>;
				};
			};

			camera1_pdn_output_low@gpio97 {
				phandle = <0x1f>;

				pins_cmd_dat {
					output-low;
					pinmux = <0x6100>;
					slew-rate = <0x1>;
				};
			};

			camera1_rst_output_high@gpio101 {
				phandle = <0x1e>;

				pins_cmd_dat {
					output-high;
					pinmux = <0x6500>;
				};
			};

			camera1_rst_output_low@gpio101 {
				phandle = <0x1d>;

				pins_cmd_dat {
					output-low;
					pinmux = <0x6500>;
				};
			};

			camera1_vcamd_output_high@gpio179 {
				phandle = <0x27>;

				pins_cmd_dat {
					output-high;
					pinmux = <0xb300>;
				};
			};

			camera1_vcamd_output_low@gpio179 {
				phandle = <0x28>;

				pins_cmd_dat {
					output-low;
					pinmux = <0xb300>;
				};
			};

			camera2_mclk_2mA@gpio108 {
				phandle = <0x34>;

				pins_cmd_dat {
					drive-strength = <0x2>;
					pinmux = <0x6c01>;
				};
			};

			camera2_mclk_4mA@gpio108 {
				phandle = <0x35>;

				pins_cmd_dat {
					drive-strength = <0x4>;
					pinmux = <0x6c01>;
				};
			};

			camera2_mclk_6mA@gpio108 {
				phandle = <0x36>;

				pins_cmd_dat {
					drive-strength = <0x6>;
					pinmux = <0x6c01>;
				};
			};

			camera2_mclk_8mA@gpio108 {
				phandle = <0x37>;

				pins_cmd_dat {
					drive-strength = <0x7>;
					pinmux = <0x6c01>;
				};
			};

			camera2_mclk_gpio_mode@gpio108 {
				phandle = <0x33>;

				pins_cmd_dat {
					drive-strength = <0x4>;
					pinmux = <0x6c00>;
				};
			};

			camera2_pdn_output_high@gpio110 {
				phandle = <0x24>;

				pins_cmd_dat {
					output-high;
					pinmux = <0x6e00>;
				};
			};

			camera2_pdn_output_low@gpio110 {
				phandle = <0x23>;

				pins_cmd_dat {
					output-low;
					pinmux = <0x6e00>;
				};
			};

			camera2_rst_output_high@gpio109 {
				phandle = <0x22>;

				pins_cmd_dat {
					output-high;
					pinmux = <0x6d00>;
				};
			};

			camera2_rst_output_low@gpio109 {
				phandle = <0x21>;

				pins_cmd_dat {
					output-low;
					pinmux = <0x6d00>;
				};
			};

			flashlightdefault {
				phandle = <0x38>;
			};

			flashlightenoutput0 {
				phandle = <0x3a>;

				pins_cmd_dat {
					output-low;
					pinmux = <0x9700>;
					slew-rate = <0x1>;
				};
			};

			flashlightenoutput1 {
				phandle = <0x39>;

				pins_cmd_dat {
					output-high;
					pinmux = <0x9700>;
					slew-rate = <0x1>;
				};
			};

			flashlightseloutput0 {
				phandle = <0x3c>;

				pins_cmd_dat {
					output-low;
					pinmux = <0x1e00>;
					slew-rate = <0x1>;
				};
			};

			flashlightseloutput1 {
				phandle = <0x3b>;

				pins_cmd_dat {
					output-high;
					pinmux = <0x1e00>;
					slew-rate = <0x1>;
				};
			};
		};
	};

	fragment@66 {
		target = <0xffffffff>;

		__overlay__ {
			cam0_enable_sensor = "s5kjns_sunny_main_ii_mipi_raw s5kjns_truly_main_iii_mipi_raw ov50d40_truly_main_i_mipi_raw";
			cam0_vcama-supply = <0xffffffff>;
			cam0_vcamaf-supply = <0xffffffff>;
			cam0_vcamd-supply = <0xffffffff>;
			cam0_vcamio-supply = <0xffffffff>;
			cam1_enable_sensor = "ov8856_aac_front_i_mipi_raw  ov8856_truly_front_ii_mipi_raw";
			cam1_vcama-supply = <0xffffffff>;
			cam1_vcamio-supply = <0xffffffff>;
			cam2_enable_sensor = "sc202cs_sunny_marco_i_mipi_raw sc202cs_aac_marco_ii_mipi_raw";
			cam2_vcama-supply = <0xffffffff>;
			cam2_vcamio-supply = <0xffffffff>;
			pinctrl-0 = <0x18>;
			pinctrl-1 = <0x19>;
			pinctrl-10 = <0x22>;
			pinctrl-11 = <0x23>;
			pinctrl-12 = <0x24>;
			pinctrl-13 = <0x25>;
			pinctrl-14 = <0x26>;
			pinctrl-15 = <0x27>;
			pinctrl-16 = <0x28>;
			pinctrl-17 = <0x29>;
			pinctrl-18 = <0x2a>;
			pinctrl-19 = <0x2b>;
			pinctrl-2 = <0x1a>;
			pinctrl-20 = <0x2c>;
			pinctrl-21 = <0x2d>;
			pinctrl-22 = <0x2e>;
			pinctrl-23 = <0x2f>;
			pinctrl-24 = <0x30>;
			pinctrl-25 = <0x31>;
			pinctrl-26 = <0x32>;
			pinctrl-27 = <0x33>;
			pinctrl-28 = <0x34>;
			pinctrl-29 = <0x35>;
			pinctrl-3 = <0x1b>;
			pinctrl-30 = <0x36>;
			pinctrl-31 = <0x37>;
			pinctrl-4 = <0x1c>;
			pinctrl-5 = <0x1d>;
			pinctrl-6 = <0x1e>;
			pinctrl-7 = <0x1f>;
			pinctrl-8 = <0x20>;
			pinctrl-9 = <0x21>;
			pinctrl-names = "default", "cam0_rst0", "cam0_rst1", "cam0_pnd0", "cam0_pnd1", "cam1_rst0", "cam1_rst1", "cam1_pnd0", "cam1_pnd1", "cam2_rst0", "cam2_rst1", "cam2_pnd0", "cam2_pnd1", "cam0_vcamd_on", "cam0_vcamd_off", "cam1_vcamd_on", "cam1_vcamd_off", "cam0_mclk_off", "cam0_mclk_2mA", "cam0_mclk_4mA", "cam0_mclk_6mA", "cam0_mclk_8mA", "cam1_mclk_off", "cam1_mclk_2mA", "cam1_mclk_4mA", "cam1_mclk_6mA", "cam1_mclk_8mA", "cam2_mclk_off", "cam2_mclk_2mA", "cam2_mclk_4mA", "cam2_mclk_6mA", "cam2_mclk_8mA";
			status = "okay";
		};
	};

	fragment@67 {
		target = <0xffffffff>;

		__overlay__ {
			pinctrl-0 = <0x38>;
			pinctrl-1 = <0x39>;
			pinctrl-2 = <0x3a>;
			pinctrl-3 = <0x3b>;
			pinctrl-4 = <0x3c>;
			pinctrl-names = "default", "hw_ch0_high", "hw_ch0_low", "hw_ch1_high", "hw_ch1_low";
			status = "okay";
		};
	};

	fragment@68 {
		target = <0xffffffff>;

		__overlay__ {
			#address-cells = <0x1>;
			#size-cells = <0x0>;

			fpc_tee@2 {
				VFP-supply = <0xffffffff>;
				avdd-supply = <0xffffffff>;
				compatible = "fpc,fpc_spi";
				fpc,enable-wakeup;
				netlink-event = <0x1f>;
				reg = <0x0>;
				spi-max-frequency = <0x989680>;
				status = "okay";
			};
		};
	};

	fragment@69 {
		target = <0xffffffff>;

		__overlay__ {
			VFP-supply = <0xffffffff>;
			pinctrl-0 = <0x3d>;
			pinctrl-1 = <0x3e>;
			pinctrl-2 = <0x3f>;
			pinctrl-3 = <0x40>;
			pinctrl-names = "fpsensor_fpc_rst_low", "fpsensor_fpc_rst_high", "fpsensor_fpc_cs_low", "fpsensor_fpc_cs_high";
			status = "okay";
		};
	};

	fragment@7 {
		target = <0xffffffff>;

		__overlay__ {

			led@0 {
				compatible = "mediatek,red";
				data = <0x1>;
				led_mode = <0x0>;
				phandle = <0x4c>;
				pwm_config = <0x0 0x0 0x0 0x0 0x0>;
			};

			led@1 {
				compatible = "mediatek,green";
				data = <0x1>;
				led_mode = <0x0>;
				phandle = <0x4d>;
				pwm_config = <0x0 0x0 0x0 0x0 0x0>;
			};

			led@2 {
				compatible = "mediatek,blue";
				data = <0x1>;
				led_mode = <0x0>;
				phandle = <0x4e>;
				pwm_config = <0x0 0x0 0x0 0x0 0x0>;
			};

			led@3 {
				compatible = "mediatek,jogball-backlight";
				data = <0x1>;
				led_mode = <0x0>;
				phandle = <0x4f>;
				pwm_config = <0x0 0x0 0x0 0x0 0x0>;
			};

			led@4 {
				compatible = "mediatek,keyboard-backlight";
				data = <0x1>;
				led_mode = <0x0>;
				phandle = <0x50>;
				pwm_config = <0x0 0x0 0x0 0x0 0x0>;
			};

			led@5 {
				compatible = "mediatek,button-backlight";
				data = <0x1>;
				led_mode = <0x0>;
				phandle = <0x51>;
				pwm_config = <0x0 0x0 0x0 0x0 0x0>;
			};

			led@6 {
				compatible = "mediatek,lcd-backlight";
				data = <0x1>;
				led_mode = <0x4>;
				phandle = <0x52>;
				pwm_config = <0x0 0x3 0x0 0x0 0x0>;
			};

			vibrator@0 {
				compatible = "mediatek,vibrator";
				phandle = <0x53>;
				vib_limit = <0x9>;
				vib_timer = <0x19>;
				vib_vol = <0x9>;
			};
		};
	};

	fragment@70 {
		target = <0xffffffff>;

		__overlay__ {

			fpsensor_fpc_cs_high {
				phandle = <0x40>;

				pins_cmd_dat {
					bias-pull-up;
					pinmux = <0x1902>;
					slew-rate = <0x1>;
				};
			};

			fpsensor_fpc_cs_low {
				phandle = <0x3f>;

				pins_cmd_dat {
					output-low;
					pinmux = <0x1900>;
					slew-rate = <0x1>;
				};
			};

			fpsensor_fpc_rst_high {
				phandle = <0x3e>;

				pins_cmd_dat {
					output-high;
					pinmux = <0x1f00>;
					slew-rate = <0x1>;
				};
			};

			fpsensor_fpc_rst_low {
				phandle = <0x3d>;

				pins_cmd_dat {
					output-low;
					pinmux = <0x1f00>;
					slew-rate = <0x1>;
				};
			};
		};
	};

	fragment@71 {
		target = <0xffffffff>;

		__overlay__ {
			avdd-supply = <0xffffffff>;
			pinctrl-0 = <0x41>;
			pinctrl-1 = <0x42>;
			pinctrl-2 = <0x43>;
			pinctrl-3 = <0x44>;
			pinctrl-4 = <0x45>;
			pinctrl-5 = <0x46>;
			pinctrl-6 = <0x47>;
			pinctrl-names = "default", "rst-low", "rst-high", "irq-init", "spi-default", "irq_rst-low", "irq_rst-high";
			status = "okay";
		};
	};

	fragment@72 {
		target = <0xffffffff>;

		__overlay__ {

			fp_default {
				phandle = <0x45>;

				pins_cmd2_dat {
					bias-pull-down;
					pinmux = <0x1b02>;
					slew-rate = <0x1>;
				};

				pins_cmd3_dat {
					bias-pull-down;
					pinmux = <0x1c02>;
					slew-rate = <0x0>;
				};

				pins_cmd4_dat {
					bias-pull-down;
					pinmux = <0x1a02>;
					slew-rate = <0x1>;
				};

				pins_cmd_dat {
					bias-pull-up;
					pinmux = <0x1902>;
					slew-rate = <0x1>;
				};
			};
		};
	};

	fragment@73 {
		target = <0xffffffff>;

		__overlay__ {

			fp_eint@8 {
				phandle = <0x44>;

				pins_cmd_dat {
					bias-pull-down = <0x0>;
					pinmux = <0x800>;
					slew-rate = <0x0>;
				};
			};

			silfpdefault {
				phandle = <0x41>;
			};

			state_irq_to_reset_high {
				phandle = <0x47>;

				pins_cmd_dat {
					output-high;
					pinmux = <0x800>;
					slew-rate = <0x1>;
				};
			};

			state_irq_to_reset_low {
				phandle = <0x46>;

				pins_cmd_dat {
					output-low;
					pinmux = <0x800>;
					slew-rate = <0x1>;
				};
			};

			state_reset_high {
				phandle = <0x43>;

				pins_cmd_dat {
					output-high;
					pinmux = <0x1f00>;
					slew-rate = <0x1>;
				};
			};

			state_reset_low {
				phandle = <0x42>;

				pins_cmd_dat {
					output-low;
					pinmux = <0x1f00>;
					slew-rate = <0x1>;
				};
			};
		};
	};

	fragment@74 {
		target = <0xffffffff>;

		__overlay__ {

			audio_fs15xx {
				compatible = "foursemi,fs15xx";
				fsm,cmd-gpio = <0xffffffff 0xa0 0x0>;
				fsm,dev-type = <0x1>;
				fsm,id-gpio = <0xffffffff 0x96 0x0>;
				fsm,mod-gpio = <0xffffffff 0x99 0x0>;
				phandle = <0x61>;
				pinctrl-0 = <0x48>;
				pinctrl-1 = <0x49>;
				pinctrl-2 = <0x4a>;
				pinctrl-3 = <0x4b>;
				pinctrl-names = "fs15xx_id_default", "fs15xx_id_active", "fs15xx_cmd_default", "fs15xx_mod_default";
				status = "okay";
			};
		};
	};

	fragment@75 {
		target = <0xffffffff>;

		__overlay__ {

			fs15xx_cmd_default {
				phandle = <0x4a>;

				pins_cmd_dat {
					output-low;
					pinmux = <0xa000>;
					slew-rate = <0x1>;
				};
			};

			fs15xx_id_active {
				phandle = <0x49>;

				pins_cmd_dat {
					bias-pull-up;
					pinmux = <0x9600>;
					slew-rate = <0x0>;
				};
			};

			fs15xx_id_default {
				phandle = <0x48>;

				pins_cmd_dat {
					bias-disable;
					output-low;
					pinmux = <0x9600>;
					slew-rate = <0x0>;
				};
			};

			fs15xx_mod_default {
				phandle = <0x4b>;

				pins_cmd_dat {
					output-low;
					pinmux = <0x9900>;
					slew-rate = <0x1>;
				};
			};
		};
	};

	fragment@8 {
		target = <0xffffffff>;

		__overlay__ {
			clock-frequency = <0x61a80>;

			mtk-usb@60 {
				compatible = "mediatek,mtk-usb";
				reg = <0x60>;
				status = "okay";
			};
		};
	};

	fragment@9 {
		target = <0xffffffff>;

		__overlay__ {
			accdet-mic-mode = <0x1>;
			accdet-mic-vol = <0x6>;
			accdet-plugout-debounce = <0x1>;
			headset-eint-level-pol = <0x8>;
			headset-four-key-threshold = <0x0 0x3a 0x79 0xc0 0x190>;
			headset-mode-setting = <0x500 0x500 0x1 0x1f0 0x800 0x800 0x20 0x44 0x0 0x0 0xe 0x0 0x0 0x0 0x0>;
			headset-three-key-threshold = <0x0 0x50 0xdc 0x190>;
			headset-three-key-threshold-CDD = <0x0 0x79 0xc0 0x258>;
			status = "okay";
		};
	};
};
